/* Generated by GNU Make 4.2.1. Do not edit. */

#include <asm-generic/embox.lds.h>

#define MODULE_ENRTY(section_, module_) \
		__module_##module_##_##section_##_vma = .; \
		*(.section_.module.module_); \
		__module_##module_##_##section_##_len = ABSOLUTE(. - \
			ABSOLUTE(__module_##module_##_##section_##_vma));

SECTIONS {
	.data.apps : ALIGN(DEFAULT_DATA_ALIGNMENT) {
		*(.data) } /* .data.apps */
	.bss.apps : ALIGN(DEFAULT_DATA_ALIGNMENT) {
		*(.bss) } /* .bss.apps */
	.text : ALIGN(DEFAULT_TEXT_ALIGNMENT) {
		MODULE_ENRTY(text,embox__arch__system)
		MODULE_ENRTY(text,embox__arch__generic__onecpu)
		MODULE_ENRTY(text,embox__arch__x86__kernel__interrupt)
		MODULE_ENRTY(text,embox__arch__x86__kernel__context)
		MODULE_ENRTY(text,embox__arch__x86__mmu)
		MODULE_ENRTY(text,embox__arch__generic__syscall_stub)
		MODULE_ENRTY(text,embox__arch__generic__nousermode)
		MODULE_ENRTY(text,embox__arch__generic__nosmp)
		MODULE_ENRTY(text,embox__compat__posix__errno__task_local)
		MODULE_ENRTY(text,embox__kernel__Kernel)
		MODULE_ENRTY(text,embox__kernel__spinlock)
		MODULE_ENRTY(text,embox__lib__debug__whereami)
		MODULE_ENRTY(text,embox__arch__x86__kernel__arch)
		MODULE_ENRTY(text,embox__arch__x86__kernel__locore)
		MODULE_ENRTY(text,embox__arch__x86__vfork)
		MODULE_ENRTY(text,embox__arch__x86__stackframe)
		MODULE_ENRTY(text,embox__arch__x86__libarch)
		MODULE_ENRTY(text,embox__arch__x86__mmuinfo)
		MODULE_ENRTY(text,embox__driver__interrupt__i8259)
		MODULE_ENRTY(text,embox__driver__clock__pit)
		MODULE_ENRTY(text,embox__driver__serial__i8250)
		MODULE_ENRTY(text,embox__driver__diag)
		MODULE_ENRTY(text,embox__driver__virtual__null)
		MODULE_ENRTY(text,embox__driver__virtual__zero)
		MODULE_ENRTY(text,embox__driver__net__loopback)
		MODULE_ENRTY(text,embox__driver__net__virtio)
		MODULE_ENRTY(text,embox__driver__ide)
		MODULE_ENRTY(text,embox__driver__usb__class__mass_storage)
		MODULE_ENRTY(text,embox__driver__usb__hc__ohci_pci)
		MODULE_ENRTY(text,embox__profiler__tracing)
		MODULE_ENRTY(text,embox__mem__phymem)
		MODULE_ENRTY(text,embox__kernel__timer__sys_timer)
		MODULE_ENRTY(text,embox__kernel__time__kernel_time)
		MODULE_ENRTY(text,embox__kernel__irq)
		MODULE_ENRTY(text,embox__kernel__critical)
		MODULE_ENRTY(text,embox__kernel__timer__sleep)
		MODULE_ENRTY(text,embox__kernel__timer__strategy__list_timer)
		MODULE_ENRTY(text,embox__kernel__time__timekeeper)
		MODULE_ENRTY(text,embox__kernel__task__multi)
		MODULE_ENRTY(text,embox__kernel__thread__core)
		MODULE_ENRTY(text,embox__kernel__stack)
		MODULE_ENRTY(text,embox__kernel__sched__strategy__priority_based)
		MODULE_ENRTY(text,embox__kernel__thread__signal__sigstate)
		MODULE_ENRTY(text,embox__kernel__thread__signal__siginfoq)
		MODULE_ENRTY(text,embox__kernel__task__resource__env)
		MODULE_ENRTY(text,embox__mem__pool_adapter)
		MODULE_ENRTY(text,embox__mem__static_heap)
		MODULE_ENRTY(text,embox__mem__heap_bm)
		MODULE_ENRTY(text,embox__mem__bitmask)
		MODULE_ENRTY(text,embox__fs__node)
		MODULE_ENRTY(text,embox__fs__rootfs)
		MODULE_ENRTY(text,embox__fs__driver__initfs_old)
		MODULE_ENRTY(text,embox__fs__driver__ramfs_old)
		MODULE_ENRTY(text,embox__fs__driver__ext2)
		MODULE_ENRTY(text,embox__fs__driver__fat_old)
		MODULE_ENRTY(text,embox__fs__driver__nfs)
		MODULE_ENRTY(text,embox__fs__driver__devfs_old)
		MODULE_ENRTY(text,embox__test__critical)
		MODULE_ENRTY(text,embox__test__recursion)
		MODULE_ENRTY(text,embox__test__stdio__printf_test)
		MODULE_ENRTY(text,embox__test__posix__poll_test)
		MODULE_ENRTY(text,embox__test__posix__select_test)
		MODULE_ENRTY(text,embox__test__posix__pipe_test)
		MODULE_ENRTY(text,embox__test__posix__ppty_test)
		MODULE_ENRTY(text,embox__test__stdlib__bsearch_test)
		MODULE_ENRTY(text,embox__test__stdlib__qsort_test)
		MODULE_ENRTY(text,embox__test__posix__environ_test)
		MODULE_ENRTY(text,embox__test__posix__getopt_test)
		MODULE_ENRTY(text,embox__test__math__math_test)
		MODULE_ENRTY(text,embox__test__math__fpu_context_consistency_test)
		MODULE_ENRTY(text,embox__cmd__sh__tish)
		MODULE_ENRTY(text,embox__init__system_start_service)
		MODULE_ENRTY(text,embox__cmd__service)
		MODULE_ENRTY(text,embox__cmd__net__arp)
		MODULE_ENRTY(text,embox__cmd__net__netstat)
		MODULE_ENRTY(text,embox__cmd__net__arping)
		MODULE_ENRTY(text,embox__cmd__net__rarping)
		MODULE_ENRTY(text,embox__cmd__net__ifconfig)
		MODULE_ENRTY(text,embox__cmd__net__ping)
		MODULE_ENRTY(text,embox__cmd__net__iptables)
		MODULE_ENRTY(text,embox__cmd__net__route)
		MODULE_ENRTY(text,embox__cmd__net__ftp)
		MODULE_ENRTY(text,embox__cmd__net__sftp)
		MODULE_ENRTY(text,embox__cmd__net__tftp)
		MODULE_ENRTY(text,embox__cmd__net__snmpd)
		MODULE_ENRTY(text,embox__cmd__net__ntpdate)
		MODULE_ENRTY(text,embox__cmd__net__telnetd)
		MODULE_ENRTY(text,embox__cmd__net__nslookup)
		MODULE_ENRTY(text,embox__cmd__net__getmail)
		MODULE_ENRTY(text,embox__cmd__net__sendmail)
		MODULE_ENRTY(text,embox__cmd__net__httpd)
		MODULE_ENRTY(text,embox__cmd__net__httpd_cgi)
		MODULE_ENRTY(text,embox__service__http_admin)
		MODULE_ENRTY(text,embox__demo__website)
		MODULE_ENRTY(text,embox__cmd__net__netmanager)
		MODULE_ENRTY(text,embox__cmd__wc)
		MODULE_ENRTY(text,embox__cmd__head)
		MODULE_ENRTY(text,embox__cmd__fs__dd)
		MODULE_ENRTY(text,embox__cmd__fs__md5sum)
		MODULE_ENRTY(text,embox__cmd__fs__uniq)
		MODULE_ENRTY(text,embox__cmd__fs__cat)
		MODULE_ENRTY(text,embox__cmd__fs__cd)
		MODULE_ENRTY(text,embox__cmd__fs__pwd)
		MODULE_ENRTY(text,embox__cmd__fs__ls)
		MODULE_ENRTY(text,embox__cmd__fs__du)
		MODULE_ENRTY(text,embox__cmd__fs__rm)
		MODULE_ENRTY(text,embox__cmd__fs__mkfs)
		MODULE_ENRTY(text,embox__cmd__fs__mount)
		MODULE_ENRTY(text,embox__cmd__fs__more)
		MODULE_ENRTY(text,embox__cmd__fs__umount)
		MODULE_ENRTY(text,embox__cmd__fs__stat)
		MODULE_ENRTY(text,embox__cmd__fs__echo)
		MODULE_ENRTY(text,embox__cmd__fs__touch)
		MODULE_ENRTY(text,embox__cmd__fs__mkdir)
		MODULE_ENRTY(text,embox__cmd__fs__cp)
		MODULE_ENRTY(text,embox__cmd__fs__mv)
		MODULE_ENRTY(text,embox__cmd__help)
		MODULE_ENRTY(text,embox__cmd__man)
		MODULE_ENRTY(text,embox__cmd__sys__uname)
		MODULE_ENRTY(text,embox__cmd__sys__env)
		MODULE_ENRTY(text,embox__cmd__sys__export)
		MODULE_ENRTY(text,embox__cmd__sys__version)
		MODULE_ENRTY(text,embox__cmd__sys__date)
		MODULE_ENRTY(text,embox__cmd__sys__shutdown)
		MODULE_ENRTY(text,embox__cmd__lsmod)
		MODULE_ENRTY(text,embox__cmd__test)
		MODULE_ENRTY(text,embox__cmd__proc__nice)
		MODULE_ENRTY(text,embox__cmd__proc__renice)
		MODULE_ENRTY(text,embox__cmd__proc__thread)
		MODULE_ENRTY(text,embox__cmd__proc__top)
		MODULE_ENRTY(text,embox__cmd__mmuinfo)
		MODULE_ENRTY(text,embox__cmd__hw__mmutrans)
		MODULE_ENRTY(text,embox__cmd__mem)
		MODULE_ENRTY(text,embox__cmd__ide)
		MODULE_ENRTY(text,embox__cmd__lspci)
		MODULE_ENRTY(text,embox__cmd__hw__lsusb)
		MODULE_ENRTY(text,embox__cmd__hw__lsblk)
		MODULE_ENRTY(text,embox__cmd__hw__partition)
		MODULE_ENRTY(text,embox__cmd__cpuinfo)
		MODULE_ENRTY(text,embox__cmd__testing__block_dev_test)
		MODULE_ENRTY(text,embox__cmd__testing__ticker)
		MODULE_ENRTY(text,embox__net__core)
		MODULE_ENRTY(text,embox__net__skbuff)
		MODULE_ENRTY(text,embox__net__skbuff_data)
		MODULE_ENRTY(text,embox__net__skbuff_extra)
		MODULE_ENRTY(text,embox__net__socket)
		MODULE_ENRTY(text,embox__net__dev)
		MODULE_ENRTY(text,embox__net__af_inet)
		MODULE_ENRTY(text,embox__net__ipv4)
		MODULE_ENRTY(text,embox__net__arp)
		MODULE_ENRTY(text,embox__net__rarp)
		MODULE_ENRTY(text,embox__net__icmpv4)
		MODULE_ENRTY(text,embox__net__udp)
		MODULE_ENRTY(text,embox__net__tcp)
		MODULE_ENRTY(text,embox__net__udp_sock)
		MODULE_ENRTY(text,embox__net__tcp_sock)
		MODULE_ENRTY(text,embox__net__raw_sock)
		MODULE_ENRTY(text,embox__net__net_entry)
		MODULE_ENRTY(text,embox__compat__libc__all)
		MODULE_ENRTY(text,embox__compat__libc__stdio__asprintf)
		MODULE_ENRTY(text,embox__compat__libc__math_builtins)
		MODULE_ENRTY(text,embox__compat__posix__pthread_key)
		MODULE_ENRTY(text,embox__compat__posix__proc__atexit_stub)
		MODULE_ENRTY(text,embox__compat__posix__fs__rewinddir_stub)
		MODULE_ENRTY(text,embox__compat__atomic__pseudo_atomic)
		MODULE_ENRTY(text,embox__util__LibUtil)
		MODULE_ENRTY(text,embox__framework__LibFramework)
		MODULE_ENRTY(text,embox__test__mem__memmove)
		MODULE_ENRTY(text,embox__compat__libc__assert)
		MODULE_ENRTY(text,embox__lib__Printk)
		MODULE_ENRTY(text,embox__compat__libc__stdio__print)
		MODULE_ENRTY(text,embox__compat__libc__stdlib__core)
		MODULE_ENRTY(text,embox__compat__libc__stdlib__config)
		MODULE_ENRTY(text,embox__compat__libc__stdlib__rand)
		MODULE_ENRTY(text,embox__compat__libc__str)
		MODULE_ENRTY(text,embox__compat__libc__type)
		MODULE_ENRTY(text,embox__compat__libc__stdio__sprintf)
		MODULE_ENRTY(text,third_party__lib__libgcc_toolchain)
		MODULE_ENRTY(text,embox__mem__vmem_depends)
		MODULE_ENRTY(text,embox__mem__vmem_alloc_single_pool)
		MODULE_ENRTY(text,embox__mem__mmap_header)
		MODULE_ENRTY(text,embox__mem__mmap)
		MODULE_ENRTY(text,embox__mem__marea)
		MODULE_ENRTY(text,embox__mem__marea_header)
		MODULE_ENRTY(text,embox__mem__pool_ndebug)
		MODULE_ENRTY(text,embox__kernel__task__resource__mmap_trivial)
		MODULE_ENRTY(text,embox__fs__syslib__idesc_mmap_stub)
		MODULE_ENRTY(text,embox__mem__vmem_header)
		MODULE_ENRTY(text,embox__kernel__task__kernel_task)
		MODULE_ENRTY(text,embox__kernel__task__task_resource)
		MODULE_ENRTY(text,embox__util__Array)
		MODULE_ENRTY(text,embox__kernel__task__task_table)
		MODULE_ENRTY(text,embox__driver__periph_memory_mmap)
		MODULE_ENRTY(text,embox__mem__vmem_device_memory_full)
		MODULE_ENRTY(text,embox__arch__x86__testtrap)
		MODULE_ENRTY(text,embox__framework__runlevel)
		MODULE_ENRTY(text,embox__framework__mod)
		MODULE_ENRTY(text,embox__util__log)
		MODULE_ENRTY(text,embox__util__logging)
		MODULE_ENRTY(text,embox__framework__embuild_full)
		MODULE_ENRTY(text,embox__lib__debug__symbol)
		MODULE_ENRTY(text,embox__lib__execinfo__backtrace)
		MODULE_ENRTY(text,embox__arch__x86__kernel__noacpi_shutdown)
		MODULE_ENRTY(text,embox__arch__x86__kernel__entry)
		MODULE_ENRTY(text,embox__arch__x86__boot__multiboot)
		MODULE_ENRTY(text,embox__compat__posix__proc__vfork_entry)
		MODULE_ENRTY(text,embox__compat__posix__proc__exit)
		MODULE_ENRTY(text,embox__compat__posix__proc__signal)
		MODULE_ENRTY(text,embox__kernel__thread__signal_impl)
		MODULE_ENRTY(text,embox__kernel__task__resource__sig_table)
		MODULE_ENRTY(text,embox__compat__posix__proc__sigset)
		MODULE_ENRTY(text,embox__util__Bitmap)
		MODULE_ENRTY(text,embox__util__Bit)
		MODULE_ENRTY(text,embox__kernel__task__resource__argv)
		MODULE_ENRTY(text,embox__kernel__task__resource__vfork)
		MODULE_ENRTY(text,embox__driver__clock__pit_regs_x86)
		MODULE_ENRTY(text,embox__kernel__time__clock_source)
		MODULE_ENRTY(text,embox__kernel__time__slowdown)
		MODULE_ENRTY(text,embox__kernel__time__timer_handler)
		MODULE_ENRTY(text,embox__kernel__lthread__lthread)
		MODULE_ENRTY(text,embox__kernel__sched__sched)
		MODULE_ENRTY(text,embox__kernel__sched__idle_thread)
		MODULE_ENRTY(text,embox__kernel__sched__boot_thread)
		MODULE_ENRTY(text,embox__kernel__addr_space_stub)
		MODULE_ENRTY(text,embox__kernel__sched__schedee)
		MODULE_ENRTY(text,embox__kernel__sched__strategy__runq__prioq)
		MODULE_ENRTY(text,embox__kernel__sched__priority__inherit)
		MODULE_ENRTY(text,embox__kernel__sched__affinity__none)
		MODULE_ENRTY(text,embox__kernel__sched__wait_queue)
		MODULE_ENRTY(text,embox__util__dlist)
		MODULE_ENRTY(text,embox__kernel__sched__waitq_protect_link_stub)
		MODULE_ENRTY(text,embox__kernel__sched__current__default)
		MODULE_ENRTY(text,embox__driver__serial__core_tty)
		MODULE_ENRTY(text,embox__util__indexator)
		MODULE_ENRTY(text,embox__driver__serial__diag)
		MODULE_ENRTY(text,embox__driver__tty__termios_ops)
		MODULE_ENRTY(text,embox__util__ring)
		MODULE_ENRTY(text,embox__driver__char_dev)
		MODULE_ENRTY(text,embox__net__l2__ethernet)
		MODULE_ENRTY(text,embox__driver__pci)
		MODULE_ENRTY(text,embox__driver__pci_chip__pci_chip_x86)
		MODULE_ENRTY(text,embox__driver__pci_bios_stub)
		MODULE_ENRTY(text,embox__driver__virtio)
		MODULE_ENRTY(text,embox__mem__sysmalloc_task_based)
		MODULE_ENRTY(text,embox__driver__block_dev)
		MODULE_ENRTY(text,embox__compat__posix__fs__libgen)
		MODULE_ENRTY(text,embox__fs__buffer_cache)
		MODULE_ENRTY(text,embox__kernel__thread__mutex)
		MODULE_ENRTY(text,embox__kernel__sched__mutex)
		MODULE_ENRTY(text,embox__util__hashtable)
		MODULE_ENRTY(text,embox__fs__buffer_no_crypt)
		MODULE_ENRTY(text,embox__driver__common)
		MODULE_ENRTY(text,embox__compat__posix__util__sleep)
		MODULE_ENRTY(text,embox__driver__block__partition)
		MODULE_ENRTY(text,embox__driver__usb__core)
		MODULE_ENRTY(text,embox__driver__scsi)
		MODULE_ENRTY(text,embox__driver__usb__hub)
		MODULE_ENRTY(text,embox__kernel__timer__itimer)
		MODULE_ENRTY(text,embox__profiler__cyg_profile)
		MODULE_ENRTY(text,embox__kernel__time__jiffies)
		MODULE_ENRTY(text,embox__kernel__time__timeval)
		MODULE_ENRTY(text,embox__kernel__irq_lock)
		MODULE_ENRTY(text,embox__kernel__irq_stack_no_protection)
		MODULE_ENRTY(text,embox__kernel__cpu__no_bkl)
		MODULE_ENRTY(text,embox__kernel__cpu__no_cpudata)
		MODULE_ENRTY(text,embox__kernel__thread__sched_wait)
		MODULE_ENRTY(text,embox__compat__posix__proc__vfork_exchanged)
		MODULE_ENRTY(text,embox__kernel__sched__sched_ticker_preempt)
		MODULE_ENRTY(text,embox__kernel__sched__timing__running)
		MODULE_ENRTY(text,embox__kernel__thread__fixed_stack)
		MODULE_ENRTY(text,embox__kernel__thread__thread_local_heap)
		MODULE_ENRTY(text,embox__kernel__thread__thread_cancel_disable)
		MODULE_ENRTY(text,embox__kernel__cpu__common)
		MODULE_ENRTY(text,embox__compat__posix__util__time)
		MODULE_ENRTY(text,embox__kernel__thread__stack_protect_none)
		MODULE_ENRTY(text,embox__util__priolist)
		MODULE_ENRTY(text,embox__mem__mspace_malloc)
		MODULE_ENRTY(text,embox__mem__boundary_markers)
		MODULE_ENRTY(text,embox__mem__heap_afterfree_default)
		MODULE_ENRTY(text,embox__kernel__task__resource__task_heap)
		MODULE_ENRTY(text,embox__util__tree)
		MODULE_ENRTY(text,embox__fs__driver__repo)
		MODULE_ENRTY(text,embox__fs__filesystem)
		MODULE_ENRTY(text,embox__fs__syslib__file_system_full)
		MODULE_ENRTY(text,embox__fs__syslib__noncache)
		MODULE_ENRTY(text,embox__fs__syslib__perm_full)
		MODULE_ENRTY(text,embox__fs__syslib__fs_full)
		MODULE_ENRTY(text,embox__fs__core)
		MODULE_ENRTY(text,embox__fs__file_desc)
		MODULE_ENRTY(text,embox__fs__idesc)
		MODULE_ENRTY(text,embox__kernel__task__resource__idesc_table)
		MODULE_ENRTY(text,embox__kernel__task__idesc)
		MODULE_ENRTY(text,embox__fs__xattr)
		MODULE_ENRTY(text,embox__security__no_security)
		MODULE_ENRTY(text,embox__fs__path_helper)
		MODULE_ENRTY(text,embox__compat__posix__util__environ)
		MODULE_ENRTY(text,embox__kernel__task__resource__errno)
		MODULE_ENRTY(text,embox__compat__posix__proc__uid)
		MODULE_ENRTY(text,embox__kernel__task__resource__u_area)
		MODULE_ENRTY(text,embox__kernel__task__resource__vfs)
		MODULE_ENRTY(text,embox__compat__posix__util__gettimeofday)
		MODULE_ENRTY(text,embox__compat__libc__str_dup)
		MODULE_ENRTY(text,embox__compat__posix__fs__open_old)
		MODULE_ENRTY(text,embox__driver__ramdisk)
		MODULE_ENRTY(text,embox__fs__journal)
		MODULE_ENRTY(text,embox__mem__slab)
		MODULE_ENRTY(text,embox__net__lib__rpc)
		MODULE_ENRTY(text,embox__fs__driver__PseudoFs)
		MODULE_ENRTY(text,embox__driver__flash__flash_nofs)
		MODULE_ENRTY(text,embox__compat__posix__idx__poll)
		MODULE_ENRTY(text,embox__compat__posix__idx__poll_table)
		MODULE_ENRTY(text,embox__fs__idesc_event)
		MODULE_ENRTY(text,embox__compat__posix__idx__pipe)
		MODULE_ENRTY(text,embox__compat__posix__fs__file_ops)
		MODULE_ENRTY(text,embox__compat__posix__fs__read)
		MODULE_ENRTY(text,embox__compat__posix__fs__write)
		MODULE_ENRTY(text,embox__compat__posix__fs__fcntl)
		MODULE_ENRTY(text,embox__compat__posix__fs__ioctl)
		MODULE_ENRTY(text,embox__compat__posix__fs__close)
		MODULE_ENRTY(text,embox__compat__posix__fs__fstat)
		MODULE_ENRTY(text,embox__compat__posix__fs__fsync)
		MODULE_ENRTY(text,embox__compat__posix__fs__readv)
		MODULE_ENRTY(text,embox__compat__posix__fs__writev)
		MODULE_ENRTY(text,embox__compat__posix__fs__ftruncate_old)
		MODULE_ENRTY(text,embox__compat__posix__idx__select)
		MODULE_ENRTY(text,embox__compat__posix__pthreads)
		MODULE_ENRTY(text,embox__kernel__thread__sync)
		MODULE_ENRTY(text,embox__kernel__thread__sem)
		MODULE_ENRTY(text,embox__kernel__thread__barrier)
		MODULE_ENRTY(text,embox__kernel__thread__cond)
		MODULE_ENRTY(text,embox__kernel__thread__rwlock)
		MODULE_ENRTY(text,embox__kernel__task__syslib__thread_key_table)
		MODULE_ENRTY(text,embox__kernel__task__resource__thread_key_table)
		MODULE_ENRTY(text,embox__framework__test)
		MODULE_ENRTY(text,embox__compat__posix__idx__ppty)
		MODULE_ENRTY(text,embox__compat__posix__util__getopt)
		MODULE_ENRTY(text,embox__lib__Tokenizer)
		MODULE_ENRTY(text,embox__lib__rl_linenoise)
		MODULE_ENRTY(text,embox__cmd__sh__shell_registry)
		MODULE_ENRTY(text,embox__compat__posix__proc__pid)
		MODULE_ENRTY(text,embox__compat__posix__proc__waitpid)
		MODULE_ENRTY(text,embox__kernel__task__syslib__waitpid)
		MODULE_ENRTY(text,embox__kernel__task__resource__waitpid)
		MODULE_ENRTY(text,embox__compat__posix__passwd)
		MODULE_ENRTY(text,embox__compat__posix__passwd_db_static)
		MODULE_ENRTY(text,embox__compat__posix__crypt)
		MODULE_ENRTY(text,embox__lib__LibCrypt)
		MODULE_ENRTY(text,embox__compat__libc__stdio__file_ops)
		MODULE_ENRTY(text,embox__compat__libc__stdio__file_pool)
		MODULE_ENRTY(text,embox__compat__libc__stdio__open)
		MODULE_ENRTY(text,embox__compat__posix__idx__dup)
		MODULE_ENRTY(text,embox__compat__libc__stdio__fputc)
		MODULE_ENRTY(text,embox__compat__libc__stdio__fwrite)
		MODULE_ENRTY(text,embox__compat__libc__stdio__funopen)
		MODULE_ENRTY(text,embox__compat__libc__stdio__stdio_static)
		MODULE_ENRTY(text,embox__compat__libc__stdio__fputs)
		MODULE_ENRTY(text,embox__cmd__exit)
		MODULE_ENRTY(text,embox__cmd__logout)
		MODULE_ENRTY(text,embox__kernel__task__resource__module_ptr)
		MODULE_ENRTY(text,embox__init__setup_tty_devfs)
		MODULE_ENRTY(text,embox__compat__libc__stdio__printf)
		MODULE_ENRTY(text,embox__compat__posix__proc__exec)
		MODULE_ENRTY(text,embox__compat__posix__proc__exec_exchanged)
		MODULE_ENRTY(text,embox__net__neighbour)
		MODULE_ENRTY(text,embox__net__ndp)
		MODULE_ENRTY(text,embox__net__lib__icmpv6)
		MODULE_ENRTY(text,embox__net__lib__ipv6)
		MODULE_ENRTY(text,embox__net__net_tx)
		MODULE_ENRTY(text,embox__net__net_no_crypt)
		MODULE_ENRTY(text,embox__net__no_af_packet)
		MODULE_ENRTY(text,embox__net__util__macaddr)
		MODULE_ENRTY(text,embox__compat__posix__net__inet_addr)
		MODULE_ENRTY(text,embox__compat__libc__stdio__all)
		MODULE_ENRTY(text,embox__compat__libc__stdio__rename_old)
		MODULE_ENRTY(text,embox__compat__libc__stdio__fseek)
		MODULE_ENRTY(text,embox__compat__posix__fs__lseek_old)
		MODULE_ENRTY(text,embox__compat__libc__stdio__scanf)
		MODULE_ENRTY(text,embox__compat__libc__stdio__perror)
		MODULE_ENRTY(text,embox__compat__libc__stdio__div)
		MODULE_ENRTY(text,embox__net__lib__dns_fixed)
		MODULE_ENRTY(text,embox__net__lib__dns_query)
		MODULE_ENRTY(text,embox__compat__posix__net__socket)
		MODULE_ENRTY(text,embox__net__route)
		MODULE_ENRTY(text,embox__compat__posix__net__gethostbyname)
		MODULE_ENRTY(text,embox__compat__posix__net__gethostent)
		MODULE_ENRTY(text,embox__net__util__hostent)
		MODULE_ENRTY(text,embox__compat__posix__net__herror)
		MODULE_ENRTY(text,embox__net__netfilter)
		MODULE_ENRTY(text,embox__compat__posix__util__getpass)
		MODULE_ENRTY(text,embox__compat__posix__termios)
		MODULE_ENRTY(text,embox__driver__tty__tty)
		MODULE_ENRTY(text,embox__driver__tty__task_breaking_enable)
		MODULE_ENRTY(text,embox__lib__tftp)
		MODULE_ENRTY(text,embox__net__lib__snmp)
		MODULE_ENRTY(text,embox__net__lib__snmp_mib__mib)
		MODULE_ENRTY(text,embox__net__lib__snmp_mib__all_mibs)
		MODULE_ENRTY(text,embox__net__lib__snmp_mib__mib_mac)
		MODULE_ENRTY(text,embox__net__lib__ntp)
		MODULE_ENRTY(text,embox__net__lib__pop3)
		MODULE_ENRTY(text,embox__net__lib__smtp)
		MODULE_ENRTY(text,embox__compat__posix__LibPosix)
		MODULE_ENRTY(text,embox__compat__posix__fs__all_old)
		MODULE_ENRTY(text,embox__compat__posix__idx__All)
		MODULE_ENRTY(text,embox__compat__posix__idx__isatty)
		MODULE_ENRTY(text,embox__compat__posix__net__All)
		MODULE_ENRTY(text,embox__compat__posix__net__gai_strerror)
		MODULE_ENRTY(text,embox__compat__posix__net__getaddrinfo)
		MODULE_ENRTY(text,embox__compat__posix__net__getprotobynumber)
		MODULE_ENRTY(text,embox__compat__posix__net__getprotoent)
		MODULE_ENRTY(text,embox__net__util__protoent)
		MODULE_ENRTY(text,embox__compat__posix__net__getservent)
		MODULE_ENRTY(text,embox__net__util__servent)
		MODULE_ENRTY(text,embox__compat__posix__net__getservbyname)
		MODULE_ENRTY(text,embox__compat__posix__net__gethostbyaddr)
		MODULE_ENRTY(text,embox__compat__posix__net__getnameinfo)
		MODULE_ENRTY(text,embox__compat__posix__net__getnetbyaddr)
		MODULE_ENRTY(text,embox__compat__posix__net__getnetent)
		MODULE_ENRTY(text,embox__net__util__netent)
		MODULE_ENRTY(text,embox__compat__posix__net__getnetbyname)
		MODULE_ENRTY(text,embox__compat__posix__net__getprotobyname)
		MODULE_ENRTY(text,embox__compat__posix__net__getservbyport)
		MODULE_ENRTY(text,embox__compat__posix__proc__All)
		MODULE_ENRTY(text,embox__compat__posix__proc__nice)
		MODULE_ENRTY(text,embox__compat__posix__proc__priority)
		MODULE_ENRTY(text,embox__compat__posix__no_utmp)
		MODULE_ENRTY(text,embox__compat__posix__util__All)
		MODULE_ENRTY(text,embox__compat__posix__util__utsname)
		MODULE_ENRTY(text,embox__compat__posix__util__gethostname)
		MODULE_ENRTY(text,embox__compat__posix__util__swab)
		MODULE_ENRTY(text,embox__compat__posix__timerfd)
		MODULE_ENRTY(text,embox__compat__posix__fnmatch)
		MODULE_ENRTY(text,embox__compat__posix__utime)
		MODULE_ENRTY(text,embox__compat__posix__sched)
		MODULE_ENRTY(text,embox__net__lib__getifaddrs)
		MODULE_ENRTY(text,third_party__lib__cjson)
		MODULE_ENRTY(text,embox__compat__libc__stdlib__system)
		MODULE_ENRTY(text,embox__compat__posix__fs__file_old)
		MODULE_ENRTY(text,embox__compat__posix__fs__chdir)
		MODULE_ENRTY(text,embox__compat__posix__fs__getcwd)
		MODULE_ENRTY(text,embox__compat__posix__fs__dirent_old)
		MODULE_ENRTY(text,embox__compat__posix__fs__chmod_old)
		MODULE_ENRTY(text,embox__compat__posix__fs__fsop_old)
		MODULE_ENRTY(text,embox__compat__posix__LibCurses)
		MODULE_ENRTY(text,embox__compat__posix__fs__umask)
		MODULE_ENRTY(text,embox__kernel__task__resource__umask)
		MODULE_ENRTY(text,embox__framework__cmd)
		MODULE_ENRTY(text,embox__lib__debug__buildinfo)
		MODULE_ENRTY(text,embox__compat__libc__time)
		MODULE_ENRTY(text,embox__framework__mod_integrity)
		MODULE_ENRTY(text,embox__lib__LibCpuInfo)
		MODULE_ENRTY(text,embox__arch__x86__cpu_info_x86)
		MODULE_ENRTY(text,embox__util__pretty_print)
		MODULE_ENRTY(text,embox__net__sock)
		MODULE_ENRTY(text,embox__net__family)
		MODULE_ENRTY(text,embox__net__net_sock)
		MODULE_ENRTY(text,embox__net__sock_noxattr)
		MODULE_ENRTY(text,embox__net__packet)
		MODULE_ENRTY(text,embox__net__lib__ipv4)
		MODULE_ENRTY(text,embox__net__net_pack)
		MODULE_ENRTY(text,embox__net__lib__arp)
		MODULE_ENRTY(text,embox__net__proto)
		MODULE_ENRTY(text,embox__net__lib__icmpv4)
		MODULE_ENRTY(text,embox__net__lib__udp)
		MODULE_ENRTY(text,embox__net__lib__tcp)
		MODULE_ENRTY(text,embox__net__net_rx)
		MODULE_ENRTY(text,embox__compat__libc__int_types)
		MODULE_ENRTY(text,embox__compat__libc__stdlib__all)
		MODULE_ENRTY(text,embox__compat__libc__stdlib__multibyte)
		MODULE_ENRTY(text,embox__compat__libc__stdlib__mktemp)
		MODULE_ENRTY(text,embox__compat__libc__wchar)
		MODULE_ENRTY(text,embox__util__SListDebug)
		MODULE_ENRTY(text,embox__kernel__thread__signal__lock)
		MODULE_ENRTY(text,embox__driver__tty__serial)
		MODULE_ENRTY(text,embox__fs__index_operation)
		MODULE_ENRTY(text,third_party__lib__linenoise)
		MODULE_ENRTY(text,embox__init__diag_fd)
		MODULE_ENRTY(text,embox__compat__posix__fs__xattr_old)
		MODULE_ENRTY(text,embox__compat__posix__fs__chown_old)
		MODULE_ENRTY(text,embox__compat__posix__fs__stat_oldfs)
		MODULE_ENRTY(text,embox__compat__posix__fs__truncate)
		MODULE_ENRTY(text,embox__compat__posix__fs__creat)
		*(.text) } /* .text */
	.rodata : ALIGN(DEFAULT_DATA_ALIGNMENT) {
		MODULE_ENRTY(rodata,embox__arch__system)
		MODULE_ENRTY(rodata,embox__arch__generic__onecpu)
		MODULE_ENRTY(rodata,embox__arch__x86__kernel__interrupt)
		MODULE_ENRTY(rodata,embox__arch__x86__kernel__context)
		MODULE_ENRTY(rodata,embox__arch__x86__mmu)
		MODULE_ENRTY(rodata,embox__arch__generic__syscall_stub)
		MODULE_ENRTY(rodata,embox__arch__generic__nousermode)
		MODULE_ENRTY(rodata,embox__arch__generic__nosmp)
		MODULE_ENRTY(rodata,embox__compat__posix__errno__task_local)
		MODULE_ENRTY(rodata,embox__kernel__Kernel)
		MODULE_ENRTY(rodata,embox__kernel__spinlock)
		MODULE_ENRTY(rodata,embox__lib__debug__whereami)
		MODULE_ENRTY(rodata,embox__arch__x86__kernel__arch)
		MODULE_ENRTY(rodata,embox__arch__x86__kernel__locore)
		MODULE_ENRTY(rodata,embox__arch__x86__vfork)
		MODULE_ENRTY(rodata,embox__arch__x86__stackframe)
		MODULE_ENRTY(rodata,embox__arch__x86__libarch)
		MODULE_ENRTY(rodata,embox__arch__x86__mmuinfo)
		MODULE_ENRTY(rodata,embox__driver__interrupt__i8259)
		MODULE_ENRTY(rodata,embox__driver__clock__pit)
		MODULE_ENRTY(rodata,embox__driver__serial__i8250)
		MODULE_ENRTY(rodata,embox__driver__diag)
		MODULE_ENRTY(rodata,embox__driver__virtual__null)
		MODULE_ENRTY(rodata,embox__driver__virtual__zero)
		MODULE_ENRTY(rodata,embox__driver__net__loopback)
		MODULE_ENRTY(rodata,embox__driver__net__virtio)
		MODULE_ENRTY(rodata,embox__driver__ide)
		MODULE_ENRTY(rodata,embox__driver__usb__class__mass_storage)
		MODULE_ENRTY(rodata,embox__driver__usb__hc__ohci_pci)
		MODULE_ENRTY(rodata,embox__profiler__tracing)
		MODULE_ENRTY(rodata,embox__mem__phymem)
		MODULE_ENRTY(rodata,embox__kernel__timer__sys_timer)
		MODULE_ENRTY(rodata,embox__kernel__time__kernel_time)
		MODULE_ENRTY(rodata,embox__kernel__irq)
		MODULE_ENRTY(rodata,embox__kernel__critical)
		MODULE_ENRTY(rodata,embox__kernel__timer__sleep)
		MODULE_ENRTY(rodata,embox__kernel__timer__strategy__list_timer)
		MODULE_ENRTY(rodata,embox__kernel__time__timekeeper)
		MODULE_ENRTY(rodata,embox__kernel__task__multi)
		MODULE_ENRTY(rodata,embox__kernel__thread__core)
		MODULE_ENRTY(rodata,embox__kernel__stack)
		MODULE_ENRTY(rodata,embox__kernel__sched__strategy__priority_based)
		MODULE_ENRTY(rodata,embox__kernel__thread__signal__sigstate)
		MODULE_ENRTY(rodata,embox__kernel__thread__signal__siginfoq)
		MODULE_ENRTY(rodata,embox__kernel__task__resource__env)
		MODULE_ENRTY(rodata,embox__mem__pool_adapter)
		MODULE_ENRTY(rodata,embox__mem__static_heap)
		MODULE_ENRTY(rodata,embox__mem__heap_bm)
		MODULE_ENRTY(rodata,embox__mem__bitmask)
		MODULE_ENRTY(rodata,embox__fs__node)
		MODULE_ENRTY(rodata,embox__fs__rootfs)
		MODULE_ENRTY(rodata,embox__fs__driver__initfs_old)
		MODULE_ENRTY(rodata,embox__fs__driver__ramfs_old)
		MODULE_ENRTY(rodata,embox__fs__driver__ext2)
		MODULE_ENRTY(rodata,embox__fs__driver__fat_old)
		MODULE_ENRTY(rodata,embox__fs__driver__nfs)
		MODULE_ENRTY(rodata,embox__fs__driver__devfs_old)
		MODULE_ENRTY(rodata,embox__test__critical)
		MODULE_ENRTY(rodata,embox__test__recursion)
		MODULE_ENRTY(rodata,embox__test__stdio__printf_test)
		MODULE_ENRTY(rodata,embox__test__posix__poll_test)
		MODULE_ENRTY(rodata,embox__test__posix__select_test)
		MODULE_ENRTY(rodata,embox__test__posix__pipe_test)
		MODULE_ENRTY(rodata,embox__test__posix__ppty_test)
		MODULE_ENRTY(rodata,embox__test__stdlib__bsearch_test)
		MODULE_ENRTY(rodata,embox__test__stdlib__qsort_test)
		MODULE_ENRTY(rodata,embox__test__posix__environ_test)
		MODULE_ENRTY(rodata,embox__test__posix__getopt_test)
		MODULE_ENRTY(rodata,embox__test__math__math_test)
		MODULE_ENRTY(rodata,embox__test__math__fpu_context_consistency_test)
		MODULE_ENRTY(rodata,embox__cmd__sh__tish)
		MODULE_ENRTY(rodata,embox__init__system_start_service)
		MODULE_ENRTY(rodata,embox__cmd__service)
		MODULE_ENRTY(rodata,embox__cmd__net__arp)
		MODULE_ENRTY(rodata,embox__cmd__net__netstat)
		MODULE_ENRTY(rodata,embox__cmd__net__arping)
		MODULE_ENRTY(rodata,embox__cmd__net__rarping)
		MODULE_ENRTY(rodata,embox__cmd__net__ifconfig)
		MODULE_ENRTY(rodata,embox__cmd__net__ping)
		MODULE_ENRTY(rodata,embox__cmd__net__iptables)
		MODULE_ENRTY(rodata,embox__cmd__net__route)
		MODULE_ENRTY(rodata,embox__cmd__net__ftp)
		MODULE_ENRTY(rodata,embox__cmd__net__sftp)
		MODULE_ENRTY(rodata,embox__cmd__net__tftp)
		MODULE_ENRTY(rodata,embox__cmd__net__snmpd)
		MODULE_ENRTY(rodata,embox__cmd__net__ntpdate)
		MODULE_ENRTY(rodata,embox__cmd__net__telnetd)
		MODULE_ENRTY(rodata,embox__cmd__net__nslookup)
		MODULE_ENRTY(rodata,embox__cmd__net__getmail)
		MODULE_ENRTY(rodata,embox__cmd__net__sendmail)
		MODULE_ENRTY(rodata,embox__cmd__net__httpd)
		MODULE_ENRTY(rodata,embox__cmd__net__httpd_cgi)
		MODULE_ENRTY(rodata,embox__service__http_admin)
		MODULE_ENRTY(rodata,embox__demo__website)
		MODULE_ENRTY(rodata,embox__cmd__net__netmanager)
		MODULE_ENRTY(rodata,embox__cmd__wc)
		MODULE_ENRTY(rodata,embox__cmd__head)
		MODULE_ENRTY(rodata,embox__cmd__fs__dd)
		MODULE_ENRTY(rodata,embox__cmd__fs__md5sum)
		MODULE_ENRTY(rodata,embox__cmd__fs__uniq)
		MODULE_ENRTY(rodata,embox__cmd__fs__cat)
		MODULE_ENRTY(rodata,embox__cmd__fs__cd)
		MODULE_ENRTY(rodata,embox__cmd__fs__pwd)
		MODULE_ENRTY(rodata,embox__cmd__fs__ls)
		MODULE_ENRTY(rodata,embox__cmd__fs__du)
		MODULE_ENRTY(rodata,embox__cmd__fs__rm)
		MODULE_ENRTY(rodata,embox__cmd__fs__mkfs)
		MODULE_ENRTY(rodata,embox__cmd__fs__mount)
		MODULE_ENRTY(rodata,embox__cmd__fs__more)
		MODULE_ENRTY(rodata,embox__cmd__fs__umount)
		MODULE_ENRTY(rodata,embox__cmd__fs__stat)
		MODULE_ENRTY(rodata,embox__cmd__fs__echo)
		MODULE_ENRTY(rodata,embox__cmd__fs__touch)
		MODULE_ENRTY(rodata,embox__cmd__fs__mkdir)
		MODULE_ENRTY(rodata,embox__cmd__fs__cp)
		MODULE_ENRTY(rodata,embox__cmd__fs__mv)
		MODULE_ENRTY(rodata,embox__cmd__help)
		MODULE_ENRTY(rodata,embox__cmd__man)
		MODULE_ENRTY(rodata,embox__cmd__sys__uname)
		MODULE_ENRTY(rodata,embox__cmd__sys__env)
		MODULE_ENRTY(rodata,embox__cmd__sys__export)
		MODULE_ENRTY(rodata,embox__cmd__sys__version)
		MODULE_ENRTY(rodata,embox__cmd__sys__date)
		MODULE_ENRTY(rodata,embox__cmd__sys__shutdown)
		MODULE_ENRTY(rodata,embox__cmd__lsmod)
		MODULE_ENRTY(rodata,embox__cmd__test)
		MODULE_ENRTY(rodata,embox__cmd__proc__nice)
		MODULE_ENRTY(rodata,embox__cmd__proc__renice)
		MODULE_ENRTY(rodata,embox__cmd__proc__thread)
		MODULE_ENRTY(rodata,embox__cmd__proc__top)
		MODULE_ENRTY(rodata,embox__cmd__mmuinfo)
		MODULE_ENRTY(rodata,embox__cmd__hw__mmutrans)
		MODULE_ENRTY(rodata,embox__cmd__mem)
		MODULE_ENRTY(rodata,embox__cmd__ide)
		MODULE_ENRTY(rodata,embox__cmd__lspci)
		MODULE_ENRTY(rodata,embox__cmd__hw__lsusb)
		MODULE_ENRTY(rodata,embox__cmd__hw__lsblk)
		MODULE_ENRTY(rodata,embox__cmd__hw__partition)
		MODULE_ENRTY(rodata,embox__cmd__cpuinfo)
		MODULE_ENRTY(rodata,embox__cmd__testing__block_dev_test)
		MODULE_ENRTY(rodata,embox__cmd__testing__ticker)
		MODULE_ENRTY(rodata,embox__net__core)
		MODULE_ENRTY(rodata,embox__net__skbuff)
		MODULE_ENRTY(rodata,embox__net__skbuff_data)
		MODULE_ENRTY(rodata,embox__net__skbuff_extra)
		MODULE_ENRTY(rodata,embox__net__socket)
		MODULE_ENRTY(rodata,embox__net__dev)
		MODULE_ENRTY(rodata,embox__net__af_inet)
		MODULE_ENRTY(rodata,embox__net__ipv4)
		MODULE_ENRTY(rodata,embox__net__arp)
		MODULE_ENRTY(rodata,embox__net__rarp)
		MODULE_ENRTY(rodata,embox__net__icmpv4)
		MODULE_ENRTY(rodata,embox__net__udp)
		MODULE_ENRTY(rodata,embox__net__tcp)
		MODULE_ENRTY(rodata,embox__net__udp_sock)
		MODULE_ENRTY(rodata,embox__net__tcp_sock)
		MODULE_ENRTY(rodata,embox__net__raw_sock)
		MODULE_ENRTY(rodata,embox__net__net_entry)
		MODULE_ENRTY(rodata,embox__compat__libc__all)
		MODULE_ENRTY(rodata,embox__compat__libc__stdio__asprintf)
		MODULE_ENRTY(rodata,embox__compat__libc__math_builtins)
		MODULE_ENRTY(rodata,embox__compat__posix__pthread_key)
		MODULE_ENRTY(rodata,embox__compat__posix__proc__atexit_stub)
		MODULE_ENRTY(rodata,embox__compat__posix__fs__rewinddir_stub)
		MODULE_ENRTY(rodata,embox__compat__atomic__pseudo_atomic)
		MODULE_ENRTY(rodata,embox__util__LibUtil)
		MODULE_ENRTY(rodata,embox__framework__LibFramework)
		MODULE_ENRTY(rodata,embox__test__mem__memmove)
		MODULE_ENRTY(rodata,embox__compat__libc__assert)
		MODULE_ENRTY(rodata,embox__lib__Printk)
		MODULE_ENRTY(rodata,embox__compat__libc__stdio__print)
		MODULE_ENRTY(rodata,embox__compat__libc__stdlib__core)
		MODULE_ENRTY(rodata,embox__compat__libc__stdlib__config)
		MODULE_ENRTY(rodata,embox__compat__libc__stdlib__rand)
		MODULE_ENRTY(rodata,embox__compat__libc__str)
		MODULE_ENRTY(rodata,embox__compat__libc__type)
		MODULE_ENRTY(rodata,embox__compat__libc__stdio__sprintf)
		MODULE_ENRTY(rodata,third_party__lib__libgcc_toolchain)
		MODULE_ENRTY(rodata,embox__mem__vmem_depends)
		MODULE_ENRTY(rodata,embox__mem__vmem_alloc_single_pool)
		MODULE_ENRTY(rodata,embox__mem__mmap_header)
		MODULE_ENRTY(rodata,embox__mem__mmap)
		MODULE_ENRTY(rodata,embox__mem__marea)
		MODULE_ENRTY(rodata,embox__mem__marea_header)
		MODULE_ENRTY(rodata,embox__mem__pool_ndebug)
		MODULE_ENRTY(rodata,embox__kernel__task__resource__mmap_trivial)
		MODULE_ENRTY(rodata,embox__fs__syslib__idesc_mmap_stub)
		MODULE_ENRTY(rodata,embox__mem__vmem_header)
		MODULE_ENRTY(rodata,embox__kernel__task__kernel_task)
		MODULE_ENRTY(rodata,embox__kernel__task__task_resource)
		MODULE_ENRTY(rodata,embox__util__Array)
		MODULE_ENRTY(rodata,embox__kernel__task__task_table)
		MODULE_ENRTY(rodata,embox__driver__periph_memory_mmap)
		MODULE_ENRTY(rodata,embox__mem__vmem_device_memory_full)
		MODULE_ENRTY(rodata,embox__arch__x86__testtrap)
		MODULE_ENRTY(rodata,embox__framework__runlevel)
		MODULE_ENRTY(rodata,embox__framework__mod)
		MODULE_ENRTY(rodata,embox__util__log)
		MODULE_ENRTY(rodata,embox__util__logging)
		MODULE_ENRTY(rodata,embox__framework__embuild_full)
		MODULE_ENRTY(rodata,embox__lib__debug__symbol)
		MODULE_ENRTY(rodata,embox__lib__execinfo__backtrace)
		MODULE_ENRTY(rodata,embox__arch__x86__kernel__noacpi_shutdown)
		MODULE_ENRTY(rodata,embox__arch__x86__kernel__entry)
		MODULE_ENRTY(rodata,embox__arch__x86__boot__multiboot)
		MODULE_ENRTY(rodata,embox__compat__posix__proc__vfork_entry)
		MODULE_ENRTY(rodata,embox__compat__posix__proc__exit)
		MODULE_ENRTY(rodata,embox__compat__posix__proc__signal)
		MODULE_ENRTY(rodata,embox__kernel__thread__signal_impl)
		MODULE_ENRTY(rodata,embox__kernel__task__resource__sig_table)
		MODULE_ENRTY(rodata,embox__compat__posix__proc__sigset)
		MODULE_ENRTY(rodata,embox__util__Bitmap)
		MODULE_ENRTY(rodata,embox__util__Bit)
		MODULE_ENRTY(rodata,embox__kernel__task__resource__argv)
		MODULE_ENRTY(rodata,embox__kernel__task__resource__vfork)
		MODULE_ENRTY(rodata,embox__driver__clock__pit_regs_x86)
		MODULE_ENRTY(rodata,embox__kernel__time__clock_source)
		MODULE_ENRTY(rodata,embox__kernel__time__slowdown)
		MODULE_ENRTY(rodata,embox__kernel__time__timer_handler)
		MODULE_ENRTY(rodata,embox__kernel__lthread__lthread)
		MODULE_ENRTY(rodata,embox__kernel__sched__sched)
		MODULE_ENRTY(rodata,embox__kernel__sched__idle_thread)
		MODULE_ENRTY(rodata,embox__kernel__sched__boot_thread)
		MODULE_ENRTY(rodata,embox__kernel__addr_space_stub)
		MODULE_ENRTY(rodata,embox__kernel__sched__schedee)
		MODULE_ENRTY(rodata,embox__kernel__sched__strategy__runq__prioq)
		MODULE_ENRTY(rodata,embox__kernel__sched__priority__inherit)
		MODULE_ENRTY(rodata,embox__kernel__sched__affinity__none)
		MODULE_ENRTY(rodata,embox__kernel__sched__wait_queue)
		MODULE_ENRTY(rodata,embox__util__dlist)
		MODULE_ENRTY(rodata,embox__kernel__sched__waitq_protect_link_stub)
		MODULE_ENRTY(rodata,embox__kernel__sched__current__default)
		MODULE_ENRTY(rodata,embox__driver__serial__core_tty)
		MODULE_ENRTY(rodata,embox__util__indexator)
		MODULE_ENRTY(rodata,embox__driver__serial__diag)
		MODULE_ENRTY(rodata,embox__driver__tty__termios_ops)
		MODULE_ENRTY(rodata,embox__util__ring)
		MODULE_ENRTY(rodata,embox__driver__char_dev)
		MODULE_ENRTY(rodata,embox__net__l2__ethernet)
		MODULE_ENRTY(rodata,embox__driver__pci)
		MODULE_ENRTY(rodata,embox__driver__pci_chip__pci_chip_x86)
		MODULE_ENRTY(rodata,embox__driver__pci_bios_stub)
		MODULE_ENRTY(rodata,embox__driver__virtio)
		MODULE_ENRTY(rodata,embox__mem__sysmalloc_task_based)
		MODULE_ENRTY(rodata,embox__driver__block_dev)
		MODULE_ENRTY(rodata,embox__compat__posix__fs__libgen)
		MODULE_ENRTY(rodata,embox__fs__buffer_cache)
		MODULE_ENRTY(rodata,embox__kernel__thread__mutex)
		MODULE_ENRTY(rodata,embox__kernel__sched__mutex)
		MODULE_ENRTY(rodata,embox__util__hashtable)
		MODULE_ENRTY(rodata,embox__fs__buffer_no_crypt)
		MODULE_ENRTY(rodata,embox__driver__common)
		MODULE_ENRTY(rodata,embox__compat__posix__util__sleep)
		MODULE_ENRTY(rodata,embox__driver__block__partition)
		MODULE_ENRTY(rodata,embox__driver__usb__core)
		MODULE_ENRTY(rodata,embox__driver__scsi)
		MODULE_ENRTY(rodata,embox__driver__usb__hub)
		MODULE_ENRTY(rodata,embox__kernel__timer__itimer)
		MODULE_ENRTY(rodata,embox__profiler__cyg_profile)
		MODULE_ENRTY(rodata,embox__kernel__time__jiffies)
		MODULE_ENRTY(rodata,embox__kernel__time__timeval)
		MODULE_ENRTY(rodata,embox__kernel__irq_lock)
		MODULE_ENRTY(rodata,embox__kernel__irq_stack_no_protection)
		MODULE_ENRTY(rodata,embox__kernel__cpu__no_bkl)
		MODULE_ENRTY(rodata,embox__kernel__cpu__no_cpudata)
		MODULE_ENRTY(rodata,embox__kernel__thread__sched_wait)
		MODULE_ENRTY(rodata,embox__compat__posix__proc__vfork_exchanged)
		MODULE_ENRTY(rodata,embox__kernel__sched__sched_ticker_preempt)
		MODULE_ENRTY(rodata,embox__kernel__sched__timing__running)
		MODULE_ENRTY(rodata,embox__kernel__thread__fixed_stack)
		MODULE_ENRTY(rodata,embox__kernel__thread__thread_local_heap)
		MODULE_ENRTY(rodata,embox__kernel__thread__thread_cancel_disable)
		MODULE_ENRTY(rodata,embox__kernel__cpu__common)
		MODULE_ENRTY(rodata,embox__compat__posix__util__time)
		MODULE_ENRTY(rodata,embox__kernel__thread__stack_protect_none)
		MODULE_ENRTY(rodata,embox__util__priolist)
		MODULE_ENRTY(rodata,embox__mem__mspace_malloc)
		MODULE_ENRTY(rodata,embox__mem__boundary_markers)
		MODULE_ENRTY(rodata,embox__mem__heap_afterfree_default)
		MODULE_ENRTY(rodata,embox__kernel__task__resource__task_heap)
		MODULE_ENRTY(rodata,embox__util__tree)
		MODULE_ENRTY(rodata,embox__fs__driver__repo)
		MODULE_ENRTY(rodata,embox__fs__filesystem)
		MODULE_ENRTY(rodata,embox__fs__syslib__file_system_full)
		MODULE_ENRTY(rodata,embox__fs__syslib__noncache)
		MODULE_ENRTY(rodata,embox__fs__syslib__perm_full)
		MODULE_ENRTY(rodata,embox__fs__syslib__fs_full)
		MODULE_ENRTY(rodata,embox__fs__core)
		MODULE_ENRTY(rodata,embox__fs__file_desc)
		MODULE_ENRTY(rodata,embox__fs__idesc)
		MODULE_ENRTY(rodata,embox__kernel__task__resource__idesc_table)
		MODULE_ENRTY(rodata,embox__kernel__task__idesc)
		MODULE_ENRTY(rodata,embox__fs__xattr)
		MODULE_ENRTY(rodata,embox__security__no_security)
		MODULE_ENRTY(rodata,embox__fs__path_helper)
		MODULE_ENRTY(rodata,embox__compat__posix__util__environ)
		MODULE_ENRTY(rodata,embox__kernel__task__resource__errno)
		MODULE_ENRTY(rodata,embox__compat__posix__proc__uid)
		MODULE_ENRTY(rodata,embox__kernel__task__resource__u_area)
		MODULE_ENRTY(rodata,embox__kernel__task__resource__vfs)
		MODULE_ENRTY(rodata,embox__compat__posix__util__gettimeofday)
		MODULE_ENRTY(rodata,embox__compat__libc__str_dup)
		MODULE_ENRTY(rodata,embox__compat__posix__fs__open_old)
		MODULE_ENRTY(rodata,embox__driver__ramdisk)
		MODULE_ENRTY(rodata,embox__fs__journal)
		MODULE_ENRTY(rodata,embox__mem__slab)
		MODULE_ENRTY(rodata,embox__net__lib__rpc)
		MODULE_ENRTY(rodata,embox__fs__driver__PseudoFs)
		MODULE_ENRTY(rodata,embox__driver__flash__flash_nofs)
		MODULE_ENRTY(rodata,embox__compat__posix__idx__poll)
		MODULE_ENRTY(rodata,embox__compat__posix__idx__poll_table)
		MODULE_ENRTY(rodata,embox__fs__idesc_event)
		MODULE_ENRTY(rodata,embox__compat__posix__idx__pipe)
		MODULE_ENRTY(rodata,embox__compat__posix__fs__file_ops)
		MODULE_ENRTY(rodata,embox__compat__posix__fs__read)
		MODULE_ENRTY(rodata,embox__compat__posix__fs__write)
		MODULE_ENRTY(rodata,embox__compat__posix__fs__fcntl)
		MODULE_ENRTY(rodata,embox__compat__posix__fs__ioctl)
		MODULE_ENRTY(rodata,embox__compat__posix__fs__close)
		MODULE_ENRTY(rodata,embox__compat__posix__fs__fstat)
		MODULE_ENRTY(rodata,embox__compat__posix__fs__fsync)
		MODULE_ENRTY(rodata,embox__compat__posix__fs__readv)
		MODULE_ENRTY(rodata,embox__compat__posix__fs__writev)
		MODULE_ENRTY(rodata,embox__compat__posix__fs__ftruncate_old)
		MODULE_ENRTY(rodata,embox__compat__posix__idx__select)
		MODULE_ENRTY(rodata,embox__compat__posix__pthreads)
		MODULE_ENRTY(rodata,embox__kernel__thread__sync)
		MODULE_ENRTY(rodata,embox__kernel__thread__sem)
		MODULE_ENRTY(rodata,embox__kernel__thread__barrier)
		MODULE_ENRTY(rodata,embox__kernel__thread__cond)
		MODULE_ENRTY(rodata,embox__kernel__thread__rwlock)
		MODULE_ENRTY(rodata,embox__kernel__task__syslib__thread_key_table)
		MODULE_ENRTY(rodata,embox__kernel__task__resource__thread_key_table)
		MODULE_ENRTY(rodata,embox__framework__test)
		MODULE_ENRTY(rodata,embox__compat__posix__idx__ppty)
		MODULE_ENRTY(rodata,embox__compat__posix__util__getopt)
		MODULE_ENRTY(rodata,embox__lib__Tokenizer)
		MODULE_ENRTY(rodata,embox__lib__rl_linenoise)
		MODULE_ENRTY(rodata,embox__cmd__sh__shell_registry)
		MODULE_ENRTY(rodata,embox__compat__posix__proc__pid)
		MODULE_ENRTY(rodata,embox__compat__posix__proc__waitpid)
		MODULE_ENRTY(rodata,embox__kernel__task__syslib__waitpid)
		MODULE_ENRTY(rodata,embox__kernel__task__resource__waitpid)
		MODULE_ENRTY(rodata,embox__compat__posix__passwd)
		MODULE_ENRTY(rodata,embox__compat__posix__passwd_db_static)
		MODULE_ENRTY(rodata,embox__compat__posix__crypt)
		MODULE_ENRTY(rodata,embox__lib__LibCrypt)
		MODULE_ENRTY(rodata,embox__compat__libc__stdio__file_ops)
		MODULE_ENRTY(rodata,embox__compat__libc__stdio__file_pool)
		MODULE_ENRTY(rodata,embox__compat__libc__stdio__open)
		MODULE_ENRTY(rodata,embox__compat__posix__idx__dup)
		MODULE_ENRTY(rodata,embox__compat__libc__stdio__fputc)
		MODULE_ENRTY(rodata,embox__compat__libc__stdio__fwrite)
		MODULE_ENRTY(rodata,embox__compat__libc__stdio__funopen)
		MODULE_ENRTY(rodata,embox__compat__libc__stdio__stdio_static)
		MODULE_ENRTY(rodata,embox__compat__libc__stdio__fputs)
		MODULE_ENRTY(rodata,embox__cmd__exit)
		MODULE_ENRTY(rodata,embox__cmd__logout)
		MODULE_ENRTY(rodata,embox__kernel__task__resource__module_ptr)
		MODULE_ENRTY(rodata,embox__init__setup_tty_devfs)
		MODULE_ENRTY(rodata,embox__compat__libc__stdio__printf)
		MODULE_ENRTY(rodata,embox__compat__posix__proc__exec)
		MODULE_ENRTY(rodata,embox__compat__posix__proc__exec_exchanged)
		MODULE_ENRTY(rodata,embox__net__neighbour)
		MODULE_ENRTY(rodata,embox__net__ndp)
		MODULE_ENRTY(rodata,embox__net__lib__icmpv6)
		MODULE_ENRTY(rodata,embox__net__lib__ipv6)
		MODULE_ENRTY(rodata,embox__net__net_tx)
		MODULE_ENRTY(rodata,embox__net__net_no_crypt)
		MODULE_ENRTY(rodata,embox__net__no_af_packet)
		MODULE_ENRTY(rodata,embox__net__util__macaddr)
		MODULE_ENRTY(rodata,embox__compat__posix__net__inet_addr)
		MODULE_ENRTY(rodata,embox__compat__libc__stdio__all)
		MODULE_ENRTY(rodata,embox__compat__libc__stdio__rename_old)
		MODULE_ENRTY(rodata,embox__compat__libc__stdio__fseek)
		MODULE_ENRTY(rodata,embox__compat__posix__fs__lseek_old)
		MODULE_ENRTY(rodata,embox__compat__libc__stdio__scanf)
		MODULE_ENRTY(rodata,embox__compat__libc__stdio__perror)
		MODULE_ENRTY(rodata,embox__compat__libc__stdio__div)
		MODULE_ENRTY(rodata,embox__net__lib__dns_fixed)
		MODULE_ENRTY(rodata,embox__net__lib__dns_query)
		MODULE_ENRTY(rodata,embox__compat__posix__net__socket)
		MODULE_ENRTY(rodata,embox__net__route)
		MODULE_ENRTY(rodata,embox__compat__posix__net__gethostbyname)
		MODULE_ENRTY(rodata,embox__compat__posix__net__gethostent)
		MODULE_ENRTY(rodata,embox__net__util__hostent)
		MODULE_ENRTY(rodata,embox__compat__posix__net__herror)
		MODULE_ENRTY(rodata,embox__net__netfilter)
		MODULE_ENRTY(rodata,embox__compat__posix__util__getpass)
		MODULE_ENRTY(rodata,embox__compat__posix__termios)
		MODULE_ENRTY(rodata,embox__driver__tty__tty)
		MODULE_ENRTY(rodata,embox__driver__tty__task_breaking_enable)
		MODULE_ENRTY(rodata,embox__lib__tftp)
		MODULE_ENRTY(rodata,embox__net__lib__snmp)
		MODULE_ENRTY(rodata,embox__net__lib__snmp_mib__mib)
		MODULE_ENRTY(rodata,embox__net__lib__snmp_mib__all_mibs)
		MODULE_ENRTY(rodata,embox__net__lib__snmp_mib__mib_mac)
		MODULE_ENRTY(rodata,embox__net__lib__ntp)
		MODULE_ENRTY(rodata,embox__net__lib__pop3)
		MODULE_ENRTY(rodata,embox__net__lib__smtp)
		MODULE_ENRTY(rodata,embox__compat__posix__LibPosix)
		MODULE_ENRTY(rodata,embox__compat__posix__fs__all_old)
		MODULE_ENRTY(rodata,embox__compat__posix__idx__All)
		MODULE_ENRTY(rodata,embox__compat__posix__idx__isatty)
		MODULE_ENRTY(rodata,embox__compat__posix__net__All)
		MODULE_ENRTY(rodata,embox__compat__posix__net__gai_strerror)
		MODULE_ENRTY(rodata,embox__compat__posix__net__getaddrinfo)
		MODULE_ENRTY(rodata,embox__compat__posix__net__getprotobynumber)
		MODULE_ENRTY(rodata,embox__compat__posix__net__getprotoent)
		MODULE_ENRTY(rodata,embox__net__util__protoent)
		MODULE_ENRTY(rodata,embox__compat__posix__net__getservent)
		MODULE_ENRTY(rodata,embox__net__util__servent)
		MODULE_ENRTY(rodata,embox__compat__posix__net__getservbyname)
		MODULE_ENRTY(rodata,embox__compat__posix__net__gethostbyaddr)
		MODULE_ENRTY(rodata,embox__compat__posix__net__getnameinfo)
		MODULE_ENRTY(rodata,embox__compat__posix__net__getnetbyaddr)
		MODULE_ENRTY(rodata,embox__compat__posix__net__getnetent)
		MODULE_ENRTY(rodata,embox__net__util__netent)
		MODULE_ENRTY(rodata,embox__compat__posix__net__getnetbyname)
		MODULE_ENRTY(rodata,embox__compat__posix__net__getprotobyname)
		MODULE_ENRTY(rodata,embox__compat__posix__net__getservbyport)
		MODULE_ENRTY(rodata,embox__compat__posix__proc__All)
		MODULE_ENRTY(rodata,embox__compat__posix__proc__nice)
		MODULE_ENRTY(rodata,embox__compat__posix__proc__priority)
		MODULE_ENRTY(rodata,embox__compat__posix__no_utmp)
		MODULE_ENRTY(rodata,embox__compat__posix__util__All)
		MODULE_ENRTY(rodata,embox__compat__posix__util__utsname)
		MODULE_ENRTY(rodata,embox__compat__posix__util__gethostname)
		MODULE_ENRTY(rodata,embox__compat__posix__util__swab)
		MODULE_ENRTY(rodata,embox__compat__posix__timerfd)
		MODULE_ENRTY(rodata,embox__compat__posix__fnmatch)
		MODULE_ENRTY(rodata,embox__compat__posix__utime)
		MODULE_ENRTY(rodata,embox__compat__posix__sched)
		MODULE_ENRTY(rodata,embox__net__lib__getifaddrs)
		MODULE_ENRTY(rodata,third_party__lib__cjson)
		MODULE_ENRTY(rodata,embox__compat__libc__stdlib__system)
		MODULE_ENRTY(rodata,embox__compat__posix__fs__file_old)
		MODULE_ENRTY(rodata,embox__compat__posix__fs__chdir)
		MODULE_ENRTY(rodata,embox__compat__posix__fs__getcwd)
		MODULE_ENRTY(rodata,embox__compat__posix__fs__dirent_old)
		MODULE_ENRTY(rodata,embox__compat__posix__fs__chmod_old)
		MODULE_ENRTY(rodata,embox__compat__posix__fs__fsop_old)
		MODULE_ENRTY(rodata,embox__compat__posix__LibCurses)
		MODULE_ENRTY(rodata,embox__compat__posix__fs__umask)
		MODULE_ENRTY(rodata,embox__kernel__task__resource__umask)
		MODULE_ENRTY(rodata,embox__framework__cmd)
		MODULE_ENRTY(rodata,embox__lib__debug__buildinfo)
		MODULE_ENRTY(rodata,embox__compat__libc__time)
		MODULE_ENRTY(rodata,embox__framework__mod_integrity)
		MODULE_ENRTY(rodata,embox__lib__LibCpuInfo)
		MODULE_ENRTY(rodata,embox__arch__x86__cpu_info_x86)
		MODULE_ENRTY(rodata,embox__util__pretty_print)
		MODULE_ENRTY(rodata,embox__net__sock)
		MODULE_ENRTY(rodata,embox__net__family)
		MODULE_ENRTY(rodata,embox__net__net_sock)
		MODULE_ENRTY(rodata,embox__net__sock_noxattr)
		MODULE_ENRTY(rodata,embox__net__packet)
		MODULE_ENRTY(rodata,embox__net__lib__ipv4)
		MODULE_ENRTY(rodata,embox__net__net_pack)
		MODULE_ENRTY(rodata,embox__net__lib__arp)
		MODULE_ENRTY(rodata,embox__net__proto)
		MODULE_ENRTY(rodata,embox__net__lib__icmpv4)
		MODULE_ENRTY(rodata,embox__net__lib__udp)
		MODULE_ENRTY(rodata,embox__net__lib__tcp)
		MODULE_ENRTY(rodata,embox__net__net_rx)
		MODULE_ENRTY(rodata,embox__compat__libc__int_types)
		MODULE_ENRTY(rodata,embox__compat__libc__stdlib__all)
		MODULE_ENRTY(rodata,embox__compat__libc__stdlib__multibyte)
		MODULE_ENRTY(rodata,embox__compat__libc__stdlib__mktemp)
		MODULE_ENRTY(rodata,embox__compat__libc__wchar)
		MODULE_ENRTY(rodata,embox__util__SListDebug)
		MODULE_ENRTY(rodata,embox__kernel__thread__signal__lock)
		MODULE_ENRTY(rodata,embox__driver__tty__serial)
		MODULE_ENRTY(rodata,embox__fs__index_operation)
		MODULE_ENRTY(rodata,third_party__lib__linenoise)
		MODULE_ENRTY(rodata,embox__init__diag_fd)
		MODULE_ENRTY(rodata,embox__compat__posix__fs__xattr_old)
		MODULE_ENRTY(rodata,embox__compat__posix__fs__chown_old)
		MODULE_ENRTY(rodata,embox__compat__posix__fs__stat_oldfs)
		MODULE_ENRTY(rodata,embox__compat__posix__fs__truncate)
		MODULE_ENRTY(rodata,embox__compat__posix__fs__creat)
		*(.rodata) } /* .rodata */
	.data : ALIGN(DEFAULT_DATA_ALIGNMENT) {
		MODULE_ENRTY(data,embox__arch__system)
		MODULE_ENRTY(data,embox__arch__generic__onecpu)
		MODULE_ENRTY(data,embox__arch__x86__kernel__interrupt)
		MODULE_ENRTY(data,embox__arch__x86__kernel__context)
		MODULE_ENRTY(data,embox__arch__x86__mmu)
		MODULE_ENRTY(data,embox__arch__generic__syscall_stub)
		MODULE_ENRTY(data,embox__arch__generic__nousermode)
		MODULE_ENRTY(data,embox__arch__generic__nosmp)
		MODULE_ENRTY(data,embox__compat__posix__errno__task_local)
		MODULE_ENRTY(data,embox__kernel__Kernel)
		MODULE_ENRTY(data,embox__kernel__spinlock)
		MODULE_ENRTY(data,embox__lib__debug__whereami)
		MODULE_ENRTY(data,embox__arch__x86__kernel__arch)
		MODULE_ENRTY(data,embox__arch__x86__kernel__locore)
		MODULE_ENRTY(data,embox__arch__x86__vfork)
		MODULE_ENRTY(data,embox__arch__x86__stackframe)
		MODULE_ENRTY(data,embox__arch__x86__libarch)
		MODULE_ENRTY(data,embox__arch__x86__mmuinfo)
		MODULE_ENRTY(data,embox__driver__interrupt__i8259)
		MODULE_ENRTY(data,embox__driver__clock__pit)
		MODULE_ENRTY(data,embox__driver__serial__i8250)
		MODULE_ENRTY(data,embox__driver__diag)
		MODULE_ENRTY(data,embox__driver__virtual__null)
		MODULE_ENRTY(data,embox__driver__virtual__zero)
		MODULE_ENRTY(data,embox__driver__net__loopback)
		MODULE_ENRTY(data,embox__driver__net__virtio)
		MODULE_ENRTY(data,embox__driver__ide)
		MODULE_ENRTY(data,embox__driver__usb__class__mass_storage)
		MODULE_ENRTY(data,embox__driver__usb__hc__ohci_pci)
		MODULE_ENRTY(data,embox__profiler__tracing)
		MODULE_ENRTY(data,embox__mem__phymem)
		MODULE_ENRTY(data,embox__kernel__timer__sys_timer)
		MODULE_ENRTY(data,embox__kernel__time__kernel_time)
		MODULE_ENRTY(data,embox__kernel__irq)
		MODULE_ENRTY(data,embox__kernel__critical)
		MODULE_ENRTY(data,embox__kernel__timer__sleep)
		MODULE_ENRTY(data,embox__kernel__timer__strategy__list_timer)
		MODULE_ENRTY(data,embox__kernel__time__timekeeper)
		MODULE_ENRTY(data,embox__kernel__task__multi)
		MODULE_ENRTY(data,embox__kernel__thread__core)
		MODULE_ENRTY(data,embox__kernel__stack)
		MODULE_ENRTY(data,embox__kernel__sched__strategy__priority_based)
		MODULE_ENRTY(data,embox__kernel__thread__signal__sigstate)
		MODULE_ENRTY(data,embox__kernel__thread__signal__siginfoq)
		MODULE_ENRTY(data,embox__kernel__task__resource__env)
		MODULE_ENRTY(data,embox__mem__pool_adapter)
		MODULE_ENRTY(data,embox__mem__static_heap)
		MODULE_ENRTY(data,embox__mem__heap_bm)
		MODULE_ENRTY(data,embox__mem__bitmask)
		MODULE_ENRTY(data,embox__fs__node)
		MODULE_ENRTY(data,embox__fs__rootfs)
		MODULE_ENRTY(data,embox__fs__driver__initfs_old)
		MODULE_ENRTY(data,embox__fs__driver__ramfs_old)
		MODULE_ENRTY(data,embox__fs__driver__ext2)
		MODULE_ENRTY(data,embox__fs__driver__fat_old)
		MODULE_ENRTY(data,embox__fs__driver__nfs)
		MODULE_ENRTY(data,embox__fs__driver__devfs_old)
		MODULE_ENRTY(data,embox__test__critical)
		MODULE_ENRTY(data,embox__test__recursion)
		MODULE_ENRTY(data,embox__test__stdio__printf_test)
		MODULE_ENRTY(data,embox__test__posix__poll_test)
		MODULE_ENRTY(data,embox__test__posix__select_test)
		MODULE_ENRTY(data,embox__test__posix__pipe_test)
		MODULE_ENRTY(data,embox__test__posix__ppty_test)
		MODULE_ENRTY(data,embox__test__stdlib__bsearch_test)
		MODULE_ENRTY(data,embox__test__stdlib__qsort_test)
		MODULE_ENRTY(data,embox__test__posix__environ_test)
		MODULE_ENRTY(data,embox__test__posix__getopt_test)
		MODULE_ENRTY(data,embox__test__math__math_test)
		MODULE_ENRTY(data,embox__test__math__fpu_context_consistency_test)
		MODULE_ENRTY(data,embox__cmd__sh__tish)
		MODULE_ENRTY(data,embox__init__system_start_service)
		MODULE_ENRTY(data,embox__cmd__service)
		MODULE_ENRTY(data,embox__cmd__net__arp)
		MODULE_ENRTY(data,embox__cmd__net__netstat)
		MODULE_ENRTY(data,embox__cmd__net__arping)
		MODULE_ENRTY(data,embox__cmd__net__rarping)
		MODULE_ENRTY(data,embox__cmd__net__ifconfig)
		MODULE_ENRTY(data,embox__cmd__net__ping)
		MODULE_ENRTY(data,embox__cmd__net__iptables)
		MODULE_ENRTY(data,embox__cmd__net__route)
		MODULE_ENRTY(data,embox__cmd__net__ftp)
		MODULE_ENRTY(data,embox__cmd__net__sftp)
		MODULE_ENRTY(data,embox__cmd__net__tftp)
		MODULE_ENRTY(data,embox__cmd__net__snmpd)
		MODULE_ENRTY(data,embox__cmd__net__ntpdate)
		MODULE_ENRTY(data,embox__cmd__net__telnetd)
		MODULE_ENRTY(data,embox__cmd__net__nslookup)
		MODULE_ENRTY(data,embox__cmd__net__getmail)
		MODULE_ENRTY(data,embox__cmd__net__sendmail)
		MODULE_ENRTY(data,embox__cmd__net__httpd)
		MODULE_ENRTY(data,embox__cmd__net__httpd_cgi)
		MODULE_ENRTY(data,embox__service__http_admin)
		MODULE_ENRTY(data,embox__demo__website)
		MODULE_ENRTY(data,embox__cmd__net__netmanager)
		MODULE_ENRTY(data,embox__cmd__wc)
		MODULE_ENRTY(data,embox__cmd__head)
		MODULE_ENRTY(data,embox__cmd__fs__dd)
		MODULE_ENRTY(data,embox__cmd__fs__md5sum)
		MODULE_ENRTY(data,embox__cmd__fs__uniq)
		MODULE_ENRTY(data,embox__cmd__fs__cat)
		MODULE_ENRTY(data,embox__cmd__fs__cd)
		MODULE_ENRTY(data,embox__cmd__fs__pwd)
		MODULE_ENRTY(data,embox__cmd__fs__ls)
		MODULE_ENRTY(data,embox__cmd__fs__du)
		MODULE_ENRTY(data,embox__cmd__fs__rm)
		MODULE_ENRTY(data,embox__cmd__fs__mkfs)
		MODULE_ENRTY(data,embox__cmd__fs__mount)
		MODULE_ENRTY(data,embox__cmd__fs__more)
		MODULE_ENRTY(data,embox__cmd__fs__umount)
		MODULE_ENRTY(data,embox__cmd__fs__stat)
		MODULE_ENRTY(data,embox__cmd__fs__echo)
		MODULE_ENRTY(data,embox__cmd__fs__touch)
		MODULE_ENRTY(data,embox__cmd__fs__mkdir)
		MODULE_ENRTY(data,embox__cmd__fs__cp)
		MODULE_ENRTY(data,embox__cmd__fs__mv)
		MODULE_ENRTY(data,embox__cmd__help)
		MODULE_ENRTY(data,embox__cmd__man)
		MODULE_ENRTY(data,embox__cmd__sys__uname)
		MODULE_ENRTY(data,embox__cmd__sys__env)
		MODULE_ENRTY(data,embox__cmd__sys__export)
		MODULE_ENRTY(data,embox__cmd__sys__version)
		MODULE_ENRTY(data,embox__cmd__sys__date)
		MODULE_ENRTY(data,embox__cmd__sys__shutdown)
		MODULE_ENRTY(data,embox__cmd__lsmod)
		MODULE_ENRTY(data,embox__cmd__test)
		MODULE_ENRTY(data,embox__cmd__proc__nice)
		MODULE_ENRTY(data,embox__cmd__proc__renice)
		MODULE_ENRTY(data,embox__cmd__proc__thread)
		MODULE_ENRTY(data,embox__cmd__proc__top)
		MODULE_ENRTY(data,embox__cmd__mmuinfo)
		MODULE_ENRTY(data,embox__cmd__hw__mmutrans)
		MODULE_ENRTY(data,embox__cmd__mem)
		MODULE_ENRTY(data,embox__cmd__ide)
		MODULE_ENRTY(data,embox__cmd__lspci)
		MODULE_ENRTY(data,embox__cmd__hw__lsusb)
		MODULE_ENRTY(data,embox__cmd__hw__lsblk)
		MODULE_ENRTY(data,embox__cmd__hw__partition)
		MODULE_ENRTY(data,embox__cmd__cpuinfo)
		MODULE_ENRTY(data,embox__cmd__testing__block_dev_test)
		MODULE_ENRTY(data,embox__cmd__testing__ticker)
		MODULE_ENRTY(data,embox__net__core)
		MODULE_ENRTY(data,embox__net__skbuff)
		MODULE_ENRTY(data,embox__net__skbuff_data)
		MODULE_ENRTY(data,embox__net__skbuff_extra)
		MODULE_ENRTY(data,embox__net__socket)
		MODULE_ENRTY(data,embox__net__dev)
		MODULE_ENRTY(data,embox__net__af_inet)
		MODULE_ENRTY(data,embox__net__ipv4)
		MODULE_ENRTY(data,embox__net__arp)
		MODULE_ENRTY(data,embox__net__rarp)
		MODULE_ENRTY(data,embox__net__icmpv4)
		MODULE_ENRTY(data,embox__net__udp)
		MODULE_ENRTY(data,embox__net__tcp)
		MODULE_ENRTY(data,embox__net__udp_sock)
		MODULE_ENRTY(data,embox__net__tcp_sock)
		MODULE_ENRTY(data,embox__net__raw_sock)
		MODULE_ENRTY(data,embox__net__net_entry)
		MODULE_ENRTY(data,embox__compat__libc__all)
		MODULE_ENRTY(data,embox__compat__libc__stdio__asprintf)
		MODULE_ENRTY(data,embox__compat__libc__math_builtins)
		MODULE_ENRTY(data,embox__compat__posix__pthread_key)
		MODULE_ENRTY(data,embox__compat__posix__proc__atexit_stub)
		MODULE_ENRTY(data,embox__compat__posix__fs__rewinddir_stub)
		MODULE_ENRTY(data,embox__compat__atomic__pseudo_atomic)
		MODULE_ENRTY(data,embox__util__LibUtil)
		MODULE_ENRTY(data,embox__framework__LibFramework)
		MODULE_ENRTY(data,embox__test__mem__memmove)
		MODULE_ENRTY(data,embox__compat__libc__assert)
		MODULE_ENRTY(data,embox__lib__Printk)
		MODULE_ENRTY(data,embox__compat__libc__stdio__print)
		MODULE_ENRTY(data,embox__compat__libc__stdlib__core)
		MODULE_ENRTY(data,embox__compat__libc__stdlib__config)
		MODULE_ENRTY(data,embox__compat__libc__stdlib__rand)
		MODULE_ENRTY(data,embox__compat__libc__str)
		MODULE_ENRTY(data,embox__compat__libc__type)
		MODULE_ENRTY(data,embox__compat__libc__stdio__sprintf)
		MODULE_ENRTY(data,third_party__lib__libgcc_toolchain)
		MODULE_ENRTY(data,embox__mem__vmem_depends)
		MODULE_ENRTY(data,embox__mem__vmem_alloc_single_pool)
		MODULE_ENRTY(data,embox__mem__mmap_header)
		MODULE_ENRTY(data,embox__mem__mmap)
		MODULE_ENRTY(data,embox__mem__marea)
		MODULE_ENRTY(data,embox__mem__marea_header)
		MODULE_ENRTY(data,embox__mem__pool_ndebug)
		MODULE_ENRTY(data,embox__kernel__task__resource__mmap_trivial)
		MODULE_ENRTY(data,embox__fs__syslib__idesc_mmap_stub)
		MODULE_ENRTY(data,embox__mem__vmem_header)
		MODULE_ENRTY(data,embox__kernel__task__kernel_task)
		MODULE_ENRTY(data,embox__kernel__task__task_resource)
		MODULE_ENRTY(data,embox__util__Array)
		MODULE_ENRTY(data,embox__kernel__task__task_table)
		MODULE_ENRTY(data,embox__driver__periph_memory_mmap)
		MODULE_ENRTY(data,embox__mem__vmem_device_memory_full)
		MODULE_ENRTY(data,embox__arch__x86__testtrap)
		MODULE_ENRTY(data,embox__framework__runlevel)
		MODULE_ENRTY(data,embox__framework__mod)
		MODULE_ENRTY(data,embox__util__log)
		MODULE_ENRTY(data,embox__util__logging)
		MODULE_ENRTY(data,embox__framework__embuild_full)
		MODULE_ENRTY(data,embox__lib__debug__symbol)
		MODULE_ENRTY(data,embox__lib__execinfo__backtrace)
		MODULE_ENRTY(data,embox__arch__x86__kernel__noacpi_shutdown)
		MODULE_ENRTY(data,embox__arch__x86__kernel__entry)
		MODULE_ENRTY(data,embox__arch__x86__boot__multiboot)
		MODULE_ENRTY(data,embox__compat__posix__proc__vfork_entry)
		MODULE_ENRTY(data,embox__compat__posix__proc__exit)
		MODULE_ENRTY(data,embox__compat__posix__proc__signal)
		MODULE_ENRTY(data,embox__kernel__thread__signal_impl)
		MODULE_ENRTY(data,embox__kernel__task__resource__sig_table)
		MODULE_ENRTY(data,embox__compat__posix__proc__sigset)
		MODULE_ENRTY(data,embox__util__Bitmap)
		MODULE_ENRTY(data,embox__util__Bit)
		MODULE_ENRTY(data,embox__kernel__task__resource__argv)
		MODULE_ENRTY(data,embox__kernel__task__resource__vfork)
		MODULE_ENRTY(data,embox__driver__clock__pit_regs_x86)
		MODULE_ENRTY(data,embox__kernel__time__clock_source)
		MODULE_ENRTY(data,embox__kernel__time__slowdown)
		MODULE_ENRTY(data,embox__kernel__time__timer_handler)
		MODULE_ENRTY(data,embox__kernel__lthread__lthread)
		MODULE_ENRTY(data,embox__kernel__sched__sched)
		MODULE_ENRTY(data,embox__kernel__sched__idle_thread)
		MODULE_ENRTY(data,embox__kernel__sched__boot_thread)
		MODULE_ENRTY(data,embox__kernel__addr_space_stub)
		MODULE_ENRTY(data,embox__kernel__sched__schedee)
		MODULE_ENRTY(data,embox__kernel__sched__strategy__runq__prioq)
		MODULE_ENRTY(data,embox__kernel__sched__priority__inherit)
		MODULE_ENRTY(data,embox__kernel__sched__affinity__none)
		MODULE_ENRTY(data,embox__kernel__sched__wait_queue)
		MODULE_ENRTY(data,embox__util__dlist)
		MODULE_ENRTY(data,embox__kernel__sched__waitq_protect_link_stub)
		MODULE_ENRTY(data,embox__kernel__sched__current__default)
		MODULE_ENRTY(data,embox__driver__serial__core_tty)
		MODULE_ENRTY(data,embox__util__indexator)
		MODULE_ENRTY(data,embox__driver__serial__diag)
		MODULE_ENRTY(data,embox__driver__tty__termios_ops)
		MODULE_ENRTY(data,embox__util__ring)
		MODULE_ENRTY(data,embox__driver__char_dev)
		MODULE_ENRTY(data,embox__net__l2__ethernet)
		MODULE_ENRTY(data,embox__driver__pci)
		MODULE_ENRTY(data,embox__driver__pci_chip__pci_chip_x86)
		MODULE_ENRTY(data,embox__driver__pci_bios_stub)
		MODULE_ENRTY(data,embox__driver__virtio)
		MODULE_ENRTY(data,embox__mem__sysmalloc_task_based)
		MODULE_ENRTY(data,embox__driver__block_dev)
		MODULE_ENRTY(data,embox__compat__posix__fs__libgen)
		MODULE_ENRTY(data,embox__fs__buffer_cache)
		MODULE_ENRTY(data,embox__kernel__thread__mutex)
		MODULE_ENRTY(data,embox__kernel__sched__mutex)
		MODULE_ENRTY(data,embox__util__hashtable)
		MODULE_ENRTY(data,embox__fs__buffer_no_crypt)
		MODULE_ENRTY(data,embox__driver__common)
		MODULE_ENRTY(data,embox__compat__posix__util__sleep)
		MODULE_ENRTY(data,embox__driver__block__partition)
		MODULE_ENRTY(data,embox__driver__usb__core)
		MODULE_ENRTY(data,embox__driver__scsi)
		MODULE_ENRTY(data,embox__driver__usb__hub)
		MODULE_ENRTY(data,embox__kernel__timer__itimer)
		MODULE_ENRTY(data,embox__profiler__cyg_profile)
		MODULE_ENRTY(data,embox__kernel__time__jiffies)
		MODULE_ENRTY(data,embox__kernel__time__timeval)
		MODULE_ENRTY(data,embox__kernel__irq_lock)
		MODULE_ENRTY(data,embox__kernel__irq_stack_no_protection)
		MODULE_ENRTY(data,embox__kernel__cpu__no_bkl)
		MODULE_ENRTY(data,embox__kernel__cpu__no_cpudata)
		MODULE_ENRTY(data,embox__kernel__thread__sched_wait)
		MODULE_ENRTY(data,embox__compat__posix__proc__vfork_exchanged)
		MODULE_ENRTY(data,embox__kernel__sched__sched_ticker_preempt)
		MODULE_ENRTY(data,embox__kernel__sched__timing__running)
		MODULE_ENRTY(data,embox__kernel__thread__fixed_stack)
		MODULE_ENRTY(data,embox__kernel__thread__thread_local_heap)
		MODULE_ENRTY(data,embox__kernel__thread__thread_cancel_disable)
		MODULE_ENRTY(data,embox__kernel__cpu__common)
		MODULE_ENRTY(data,embox__compat__posix__util__time)
		MODULE_ENRTY(data,embox__kernel__thread__stack_protect_none)
		MODULE_ENRTY(data,embox__util__priolist)
		MODULE_ENRTY(data,embox__mem__mspace_malloc)
		MODULE_ENRTY(data,embox__mem__boundary_markers)
		MODULE_ENRTY(data,embox__mem__heap_afterfree_default)
		MODULE_ENRTY(data,embox__kernel__task__resource__task_heap)
		MODULE_ENRTY(data,embox__util__tree)
		MODULE_ENRTY(data,embox__fs__driver__repo)
		MODULE_ENRTY(data,embox__fs__filesystem)
		MODULE_ENRTY(data,embox__fs__syslib__file_system_full)
		MODULE_ENRTY(data,embox__fs__syslib__noncache)
		MODULE_ENRTY(data,embox__fs__syslib__perm_full)
		MODULE_ENRTY(data,embox__fs__syslib__fs_full)
		MODULE_ENRTY(data,embox__fs__core)
		MODULE_ENRTY(data,embox__fs__file_desc)
		MODULE_ENRTY(data,embox__fs__idesc)
		MODULE_ENRTY(data,embox__kernel__task__resource__idesc_table)
		MODULE_ENRTY(data,embox__kernel__task__idesc)
		MODULE_ENRTY(data,embox__fs__xattr)
		MODULE_ENRTY(data,embox__security__no_security)
		MODULE_ENRTY(data,embox__fs__path_helper)
		MODULE_ENRTY(data,embox__compat__posix__util__environ)
		MODULE_ENRTY(data,embox__kernel__task__resource__errno)
		MODULE_ENRTY(data,embox__compat__posix__proc__uid)
		MODULE_ENRTY(data,embox__kernel__task__resource__u_area)
		MODULE_ENRTY(data,embox__kernel__task__resource__vfs)
		MODULE_ENRTY(data,embox__compat__posix__util__gettimeofday)
		MODULE_ENRTY(data,embox__compat__libc__str_dup)
		MODULE_ENRTY(data,embox__compat__posix__fs__open_old)
		MODULE_ENRTY(data,embox__driver__ramdisk)
		MODULE_ENRTY(data,embox__fs__journal)
		MODULE_ENRTY(data,embox__mem__slab)
		MODULE_ENRTY(data,embox__net__lib__rpc)
		MODULE_ENRTY(data,embox__fs__driver__PseudoFs)
		MODULE_ENRTY(data,embox__driver__flash__flash_nofs)
		MODULE_ENRTY(data,embox__compat__posix__idx__poll)
		MODULE_ENRTY(data,embox__compat__posix__idx__poll_table)
		MODULE_ENRTY(data,embox__fs__idesc_event)
		MODULE_ENRTY(data,embox__compat__posix__idx__pipe)
		MODULE_ENRTY(data,embox__compat__posix__fs__file_ops)
		MODULE_ENRTY(data,embox__compat__posix__fs__read)
		MODULE_ENRTY(data,embox__compat__posix__fs__write)
		MODULE_ENRTY(data,embox__compat__posix__fs__fcntl)
		MODULE_ENRTY(data,embox__compat__posix__fs__ioctl)
		MODULE_ENRTY(data,embox__compat__posix__fs__close)
		MODULE_ENRTY(data,embox__compat__posix__fs__fstat)
		MODULE_ENRTY(data,embox__compat__posix__fs__fsync)
		MODULE_ENRTY(data,embox__compat__posix__fs__readv)
		MODULE_ENRTY(data,embox__compat__posix__fs__writev)
		MODULE_ENRTY(data,embox__compat__posix__fs__ftruncate_old)
		MODULE_ENRTY(data,embox__compat__posix__idx__select)
		MODULE_ENRTY(data,embox__compat__posix__pthreads)
		MODULE_ENRTY(data,embox__kernel__thread__sync)
		MODULE_ENRTY(data,embox__kernel__thread__sem)
		MODULE_ENRTY(data,embox__kernel__thread__barrier)
		MODULE_ENRTY(data,embox__kernel__thread__cond)
		MODULE_ENRTY(data,embox__kernel__thread__rwlock)
		MODULE_ENRTY(data,embox__kernel__task__syslib__thread_key_table)
		MODULE_ENRTY(data,embox__kernel__task__resource__thread_key_table)
		MODULE_ENRTY(data,embox__framework__test)
		MODULE_ENRTY(data,embox__compat__posix__idx__ppty)
		MODULE_ENRTY(data,embox__compat__posix__util__getopt)
		MODULE_ENRTY(data,embox__lib__Tokenizer)
		MODULE_ENRTY(data,embox__lib__rl_linenoise)
		MODULE_ENRTY(data,embox__cmd__sh__shell_registry)
		MODULE_ENRTY(data,embox__compat__posix__proc__pid)
		MODULE_ENRTY(data,embox__compat__posix__proc__waitpid)
		MODULE_ENRTY(data,embox__kernel__task__syslib__waitpid)
		MODULE_ENRTY(data,embox__kernel__task__resource__waitpid)
		MODULE_ENRTY(data,embox__compat__posix__passwd)
		MODULE_ENRTY(data,embox__compat__posix__passwd_db_static)
		MODULE_ENRTY(data,embox__compat__posix__crypt)
		MODULE_ENRTY(data,embox__lib__LibCrypt)
		MODULE_ENRTY(data,embox__compat__libc__stdio__file_ops)
		MODULE_ENRTY(data,embox__compat__libc__stdio__file_pool)
		MODULE_ENRTY(data,embox__compat__libc__stdio__open)
		MODULE_ENRTY(data,embox__compat__posix__idx__dup)
		MODULE_ENRTY(data,embox__compat__libc__stdio__fputc)
		MODULE_ENRTY(data,embox__compat__libc__stdio__fwrite)
		MODULE_ENRTY(data,embox__compat__libc__stdio__funopen)
		MODULE_ENRTY(data,embox__compat__libc__stdio__stdio_static)
		MODULE_ENRTY(data,embox__compat__libc__stdio__fputs)
		MODULE_ENRTY(data,embox__cmd__exit)
		MODULE_ENRTY(data,embox__cmd__logout)
		MODULE_ENRTY(data,embox__kernel__task__resource__module_ptr)
		MODULE_ENRTY(data,embox__init__setup_tty_devfs)
		MODULE_ENRTY(data,embox__compat__libc__stdio__printf)
		MODULE_ENRTY(data,embox__compat__posix__proc__exec)
		MODULE_ENRTY(data,embox__compat__posix__proc__exec_exchanged)
		MODULE_ENRTY(data,embox__net__neighbour)
		MODULE_ENRTY(data,embox__net__ndp)
		MODULE_ENRTY(data,embox__net__lib__icmpv6)
		MODULE_ENRTY(data,embox__net__lib__ipv6)
		MODULE_ENRTY(data,embox__net__net_tx)
		MODULE_ENRTY(data,embox__net__net_no_crypt)
		MODULE_ENRTY(data,embox__net__no_af_packet)
		MODULE_ENRTY(data,embox__net__util__macaddr)
		MODULE_ENRTY(data,embox__compat__posix__net__inet_addr)
		MODULE_ENRTY(data,embox__compat__libc__stdio__all)
		MODULE_ENRTY(data,embox__compat__libc__stdio__rename_old)
		MODULE_ENRTY(data,embox__compat__libc__stdio__fseek)
		MODULE_ENRTY(data,embox__compat__posix__fs__lseek_old)
		MODULE_ENRTY(data,embox__compat__libc__stdio__scanf)
		MODULE_ENRTY(data,embox__compat__libc__stdio__perror)
		MODULE_ENRTY(data,embox__compat__libc__stdio__div)
		MODULE_ENRTY(data,embox__net__lib__dns_fixed)
		MODULE_ENRTY(data,embox__net__lib__dns_query)
		MODULE_ENRTY(data,embox__compat__posix__net__socket)
		MODULE_ENRTY(data,embox__net__route)
		MODULE_ENRTY(data,embox__compat__posix__net__gethostbyname)
		MODULE_ENRTY(data,embox__compat__posix__net__gethostent)
		MODULE_ENRTY(data,embox__net__util__hostent)
		MODULE_ENRTY(data,embox__compat__posix__net__herror)
		MODULE_ENRTY(data,embox__net__netfilter)
		MODULE_ENRTY(data,embox__compat__posix__util__getpass)
		MODULE_ENRTY(data,embox__compat__posix__termios)
		MODULE_ENRTY(data,embox__driver__tty__tty)
		MODULE_ENRTY(data,embox__driver__tty__task_breaking_enable)
		MODULE_ENRTY(data,embox__lib__tftp)
		MODULE_ENRTY(data,embox__net__lib__snmp)
		MODULE_ENRTY(data,embox__net__lib__snmp_mib__mib)
		MODULE_ENRTY(data,embox__net__lib__snmp_mib__all_mibs)
		MODULE_ENRTY(data,embox__net__lib__snmp_mib__mib_mac)
		MODULE_ENRTY(data,embox__net__lib__ntp)
		MODULE_ENRTY(data,embox__net__lib__pop3)
		MODULE_ENRTY(data,embox__net__lib__smtp)
		MODULE_ENRTY(data,embox__compat__posix__LibPosix)
		MODULE_ENRTY(data,embox__compat__posix__fs__all_old)
		MODULE_ENRTY(data,embox__compat__posix__idx__All)
		MODULE_ENRTY(data,embox__compat__posix__idx__isatty)
		MODULE_ENRTY(data,embox__compat__posix__net__All)
		MODULE_ENRTY(data,embox__compat__posix__net__gai_strerror)
		MODULE_ENRTY(data,embox__compat__posix__net__getaddrinfo)
		MODULE_ENRTY(data,embox__compat__posix__net__getprotobynumber)
		MODULE_ENRTY(data,embox__compat__posix__net__getprotoent)
		MODULE_ENRTY(data,embox__net__util__protoent)
		MODULE_ENRTY(data,embox__compat__posix__net__getservent)
		MODULE_ENRTY(data,embox__net__util__servent)
		MODULE_ENRTY(data,embox__compat__posix__net__getservbyname)
		MODULE_ENRTY(data,embox__compat__posix__net__gethostbyaddr)
		MODULE_ENRTY(data,embox__compat__posix__net__getnameinfo)
		MODULE_ENRTY(data,embox__compat__posix__net__getnetbyaddr)
		MODULE_ENRTY(data,embox__compat__posix__net__getnetent)
		MODULE_ENRTY(data,embox__net__util__netent)
		MODULE_ENRTY(data,embox__compat__posix__net__getnetbyname)
		MODULE_ENRTY(data,embox__compat__posix__net__getprotobyname)
		MODULE_ENRTY(data,embox__compat__posix__net__getservbyport)
		MODULE_ENRTY(data,embox__compat__posix__proc__All)
		MODULE_ENRTY(data,embox__compat__posix__proc__nice)
		MODULE_ENRTY(data,embox__compat__posix__proc__priority)
		MODULE_ENRTY(data,embox__compat__posix__no_utmp)
		MODULE_ENRTY(data,embox__compat__posix__util__All)
		MODULE_ENRTY(data,embox__compat__posix__util__utsname)
		MODULE_ENRTY(data,embox__compat__posix__util__gethostname)
		MODULE_ENRTY(data,embox__compat__posix__util__swab)
		MODULE_ENRTY(data,embox__compat__posix__timerfd)
		MODULE_ENRTY(data,embox__compat__posix__fnmatch)
		MODULE_ENRTY(data,embox__compat__posix__utime)
		MODULE_ENRTY(data,embox__compat__posix__sched)
		MODULE_ENRTY(data,embox__net__lib__getifaddrs)
		MODULE_ENRTY(data,third_party__lib__cjson)
		MODULE_ENRTY(data,embox__compat__libc__stdlib__system)
		MODULE_ENRTY(data,embox__compat__posix__fs__file_old)
		MODULE_ENRTY(data,embox__compat__posix__fs__chdir)
		MODULE_ENRTY(data,embox__compat__posix__fs__getcwd)
		MODULE_ENRTY(data,embox__compat__posix__fs__dirent_old)
		MODULE_ENRTY(data,embox__compat__posix__fs__chmod_old)
		MODULE_ENRTY(data,embox__compat__posix__fs__fsop_old)
		MODULE_ENRTY(data,embox__compat__posix__LibCurses)
		MODULE_ENRTY(data,embox__compat__posix__fs__umask)
		MODULE_ENRTY(data,embox__kernel__task__resource__umask)
		MODULE_ENRTY(data,embox__framework__cmd)
		MODULE_ENRTY(data,embox__lib__debug__buildinfo)
		MODULE_ENRTY(data,embox__compat__libc__time)
		MODULE_ENRTY(data,embox__framework__mod_integrity)
		MODULE_ENRTY(data,embox__lib__LibCpuInfo)
		MODULE_ENRTY(data,embox__arch__x86__cpu_info_x86)
		MODULE_ENRTY(data,embox__util__pretty_print)
		MODULE_ENRTY(data,embox__net__sock)
		MODULE_ENRTY(data,embox__net__family)
		MODULE_ENRTY(data,embox__net__net_sock)
		MODULE_ENRTY(data,embox__net__sock_noxattr)
		MODULE_ENRTY(data,embox__net__packet)
		MODULE_ENRTY(data,embox__net__lib__ipv4)
		MODULE_ENRTY(data,embox__net__net_pack)
		MODULE_ENRTY(data,embox__net__lib__arp)
		MODULE_ENRTY(data,embox__net__proto)
		MODULE_ENRTY(data,embox__net__lib__icmpv4)
		MODULE_ENRTY(data,embox__net__lib__udp)
		MODULE_ENRTY(data,embox__net__lib__tcp)
		MODULE_ENRTY(data,embox__net__net_rx)
		MODULE_ENRTY(data,embox__compat__libc__int_types)
		MODULE_ENRTY(data,embox__compat__libc__stdlib__all)
		MODULE_ENRTY(data,embox__compat__libc__stdlib__multibyte)
		MODULE_ENRTY(data,embox__compat__libc__stdlib__mktemp)
		MODULE_ENRTY(data,embox__compat__libc__wchar)
		MODULE_ENRTY(data,embox__util__SListDebug)
		MODULE_ENRTY(data,embox__kernel__thread__signal__lock)
		MODULE_ENRTY(data,embox__driver__tty__serial)
		MODULE_ENRTY(data,embox__fs__index_operation)
		MODULE_ENRTY(data,third_party__lib__linenoise)
		MODULE_ENRTY(data,embox__init__diag_fd)
		MODULE_ENRTY(data,embox__compat__posix__fs__xattr_old)
		MODULE_ENRTY(data,embox__compat__posix__fs__chown_old)
		MODULE_ENRTY(data,embox__compat__posix__fs__stat_oldfs)
		MODULE_ENRTY(data,embox__compat__posix__fs__truncate)
		MODULE_ENRTY(data,embox__compat__posix__fs__creat)
		*(.data) } /* .data */
	.bss : ALIGN(DEFAULT_DATA_ALIGNMENT) {
		MODULE_ENRTY(bss,embox__arch__system)
		MODULE_ENRTY(bss,embox__arch__generic__onecpu)
		MODULE_ENRTY(bss,embox__arch__x86__kernel__interrupt)
		MODULE_ENRTY(bss,embox__arch__x86__kernel__context)
		MODULE_ENRTY(bss,embox__arch__x86__mmu)
		MODULE_ENRTY(bss,embox__arch__generic__syscall_stub)
		MODULE_ENRTY(bss,embox__arch__generic__nousermode)
		MODULE_ENRTY(bss,embox__arch__generic__nosmp)
		MODULE_ENRTY(bss,embox__compat__posix__errno__task_local)
		MODULE_ENRTY(bss,embox__kernel__Kernel)
		MODULE_ENRTY(bss,embox__kernel__spinlock)
		MODULE_ENRTY(bss,embox__lib__debug__whereami)
		MODULE_ENRTY(bss,embox__arch__x86__kernel__arch)
		MODULE_ENRTY(bss,embox__arch__x86__kernel__locore)
		MODULE_ENRTY(bss,embox__arch__x86__vfork)
		MODULE_ENRTY(bss,embox__arch__x86__stackframe)
		MODULE_ENRTY(bss,embox__arch__x86__libarch)
		MODULE_ENRTY(bss,embox__arch__x86__mmuinfo)
		MODULE_ENRTY(bss,embox__driver__interrupt__i8259)
		MODULE_ENRTY(bss,embox__driver__clock__pit)
		MODULE_ENRTY(bss,embox__driver__serial__i8250)
		MODULE_ENRTY(bss,embox__driver__diag)
		MODULE_ENRTY(bss,embox__driver__virtual__null)
		MODULE_ENRTY(bss,embox__driver__virtual__zero)
		MODULE_ENRTY(bss,embox__driver__net__loopback)
		MODULE_ENRTY(bss,embox__driver__net__virtio)
		MODULE_ENRTY(bss,embox__driver__ide)
		MODULE_ENRTY(bss,embox__driver__usb__class__mass_storage)
		MODULE_ENRTY(bss,embox__driver__usb__hc__ohci_pci)
		MODULE_ENRTY(bss,embox__profiler__tracing)
		MODULE_ENRTY(bss,embox__mem__phymem)
		MODULE_ENRTY(bss,embox__kernel__timer__sys_timer)
		MODULE_ENRTY(bss,embox__kernel__time__kernel_time)
		MODULE_ENRTY(bss,embox__kernel__irq)
		MODULE_ENRTY(bss,embox__kernel__critical)
		MODULE_ENRTY(bss,embox__kernel__timer__sleep)
		MODULE_ENRTY(bss,embox__kernel__timer__strategy__list_timer)
		MODULE_ENRTY(bss,embox__kernel__time__timekeeper)
		MODULE_ENRTY(bss,embox__kernel__task__multi)
		MODULE_ENRTY(bss,embox__kernel__thread__core)
		MODULE_ENRTY(bss,embox__kernel__stack)
		MODULE_ENRTY(bss,embox__kernel__sched__strategy__priority_based)
		MODULE_ENRTY(bss,embox__kernel__thread__signal__sigstate)
		MODULE_ENRTY(bss,embox__kernel__thread__signal__siginfoq)
		MODULE_ENRTY(bss,embox__kernel__task__resource__env)
		MODULE_ENRTY(bss,embox__mem__pool_adapter)
		MODULE_ENRTY(bss,embox__mem__static_heap)
		MODULE_ENRTY(bss,embox__mem__heap_bm)
		MODULE_ENRTY(bss,embox__mem__bitmask)
		MODULE_ENRTY(bss,embox__fs__node)
		MODULE_ENRTY(bss,embox__fs__rootfs)
		MODULE_ENRTY(bss,embox__fs__driver__initfs_old)
		MODULE_ENRTY(bss,embox__fs__driver__ramfs_old)
		MODULE_ENRTY(bss,embox__fs__driver__ext2)
		MODULE_ENRTY(bss,embox__fs__driver__fat_old)
		MODULE_ENRTY(bss,embox__fs__driver__nfs)
		MODULE_ENRTY(bss,embox__fs__driver__devfs_old)
		MODULE_ENRTY(bss,embox__test__critical)
		MODULE_ENRTY(bss,embox__test__recursion)
		MODULE_ENRTY(bss,embox__test__stdio__printf_test)
		MODULE_ENRTY(bss,embox__test__posix__poll_test)
		MODULE_ENRTY(bss,embox__test__posix__select_test)
		MODULE_ENRTY(bss,embox__test__posix__pipe_test)
		MODULE_ENRTY(bss,embox__test__posix__ppty_test)
		MODULE_ENRTY(bss,embox__test__stdlib__bsearch_test)
		MODULE_ENRTY(bss,embox__test__stdlib__qsort_test)
		MODULE_ENRTY(bss,embox__test__posix__environ_test)
		MODULE_ENRTY(bss,embox__test__posix__getopt_test)
		MODULE_ENRTY(bss,embox__test__math__math_test)
		MODULE_ENRTY(bss,embox__test__math__fpu_context_consistency_test)
		MODULE_ENRTY(bss,embox__cmd__sh__tish)
		MODULE_ENRTY(bss,embox__init__system_start_service)
		MODULE_ENRTY(bss,embox__cmd__service)
		MODULE_ENRTY(bss,embox__cmd__net__arp)
		MODULE_ENRTY(bss,embox__cmd__net__netstat)
		MODULE_ENRTY(bss,embox__cmd__net__arping)
		MODULE_ENRTY(bss,embox__cmd__net__rarping)
		MODULE_ENRTY(bss,embox__cmd__net__ifconfig)
		MODULE_ENRTY(bss,embox__cmd__net__ping)
		MODULE_ENRTY(bss,embox__cmd__net__iptables)
		MODULE_ENRTY(bss,embox__cmd__net__route)
		MODULE_ENRTY(bss,embox__cmd__net__ftp)
		MODULE_ENRTY(bss,embox__cmd__net__sftp)
		MODULE_ENRTY(bss,embox__cmd__net__tftp)
		MODULE_ENRTY(bss,embox__cmd__net__snmpd)
		MODULE_ENRTY(bss,embox__cmd__net__ntpdate)
		MODULE_ENRTY(bss,embox__cmd__net__telnetd)
		MODULE_ENRTY(bss,embox__cmd__net__nslookup)
		MODULE_ENRTY(bss,embox__cmd__net__getmail)
		MODULE_ENRTY(bss,embox__cmd__net__sendmail)
		MODULE_ENRTY(bss,embox__cmd__net__httpd)
		MODULE_ENRTY(bss,embox__cmd__net__httpd_cgi)
		MODULE_ENRTY(bss,embox__service__http_admin)
		MODULE_ENRTY(bss,embox__demo__website)
		MODULE_ENRTY(bss,embox__cmd__net__netmanager)
		MODULE_ENRTY(bss,embox__cmd__wc)
		MODULE_ENRTY(bss,embox__cmd__head)
		MODULE_ENRTY(bss,embox__cmd__fs__dd)
		MODULE_ENRTY(bss,embox__cmd__fs__md5sum)
		MODULE_ENRTY(bss,embox__cmd__fs__uniq)
		MODULE_ENRTY(bss,embox__cmd__fs__cat)
		MODULE_ENRTY(bss,embox__cmd__fs__cd)
		MODULE_ENRTY(bss,embox__cmd__fs__pwd)
		MODULE_ENRTY(bss,embox__cmd__fs__ls)
		MODULE_ENRTY(bss,embox__cmd__fs__du)
		MODULE_ENRTY(bss,embox__cmd__fs__rm)
		MODULE_ENRTY(bss,embox__cmd__fs__mkfs)
		MODULE_ENRTY(bss,embox__cmd__fs__mount)
		MODULE_ENRTY(bss,embox__cmd__fs__more)
		MODULE_ENRTY(bss,embox__cmd__fs__umount)
		MODULE_ENRTY(bss,embox__cmd__fs__stat)
		MODULE_ENRTY(bss,embox__cmd__fs__echo)
		MODULE_ENRTY(bss,embox__cmd__fs__touch)
		MODULE_ENRTY(bss,embox__cmd__fs__mkdir)
		MODULE_ENRTY(bss,embox__cmd__fs__cp)
		MODULE_ENRTY(bss,embox__cmd__fs__mv)
		MODULE_ENRTY(bss,embox__cmd__help)
		MODULE_ENRTY(bss,embox__cmd__man)
		MODULE_ENRTY(bss,embox__cmd__sys__uname)
		MODULE_ENRTY(bss,embox__cmd__sys__env)
		MODULE_ENRTY(bss,embox__cmd__sys__export)
		MODULE_ENRTY(bss,embox__cmd__sys__version)
		MODULE_ENRTY(bss,embox__cmd__sys__date)
		MODULE_ENRTY(bss,embox__cmd__sys__shutdown)
		MODULE_ENRTY(bss,embox__cmd__lsmod)
		MODULE_ENRTY(bss,embox__cmd__test)
		MODULE_ENRTY(bss,embox__cmd__proc__nice)
		MODULE_ENRTY(bss,embox__cmd__proc__renice)
		MODULE_ENRTY(bss,embox__cmd__proc__thread)
		MODULE_ENRTY(bss,embox__cmd__proc__top)
		MODULE_ENRTY(bss,embox__cmd__mmuinfo)
		MODULE_ENRTY(bss,embox__cmd__hw__mmutrans)
		MODULE_ENRTY(bss,embox__cmd__mem)
		MODULE_ENRTY(bss,embox__cmd__ide)
		MODULE_ENRTY(bss,embox__cmd__lspci)
		MODULE_ENRTY(bss,embox__cmd__hw__lsusb)
		MODULE_ENRTY(bss,embox__cmd__hw__lsblk)
		MODULE_ENRTY(bss,embox__cmd__hw__partition)
		MODULE_ENRTY(bss,embox__cmd__cpuinfo)
		MODULE_ENRTY(bss,embox__cmd__testing__block_dev_test)
		MODULE_ENRTY(bss,embox__cmd__testing__ticker)
		MODULE_ENRTY(bss,embox__net__core)
		MODULE_ENRTY(bss,embox__net__skbuff)
		MODULE_ENRTY(bss,embox__net__skbuff_data)
		MODULE_ENRTY(bss,embox__net__skbuff_extra)
		MODULE_ENRTY(bss,embox__net__socket)
		MODULE_ENRTY(bss,embox__net__dev)
		MODULE_ENRTY(bss,embox__net__af_inet)
		MODULE_ENRTY(bss,embox__net__ipv4)
		MODULE_ENRTY(bss,embox__net__arp)
		MODULE_ENRTY(bss,embox__net__rarp)
		MODULE_ENRTY(bss,embox__net__icmpv4)
		MODULE_ENRTY(bss,embox__net__udp)
		MODULE_ENRTY(bss,embox__net__tcp)
		MODULE_ENRTY(bss,embox__net__udp_sock)
		MODULE_ENRTY(bss,embox__net__tcp_sock)
		MODULE_ENRTY(bss,embox__net__raw_sock)
		MODULE_ENRTY(bss,embox__net__net_entry)
		MODULE_ENRTY(bss,embox__compat__libc__all)
		MODULE_ENRTY(bss,embox__compat__libc__stdio__asprintf)
		MODULE_ENRTY(bss,embox__compat__libc__math_builtins)
		MODULE_ENRTY(bss,embox__compat__posix__pthread_key)
		MODULE_ENRTY(bss,embox__compat__posix__proc__atexit_stub)
		MODULE_ENRTY(bss,embox__compat__posix__fs__rewinddir_stub)
		MODULE_ENRTY(bss,embox__compat__atomic__pseudo_atomic)
		MODULE_ENRTY(bss,embox__util__LibUtil)
		MODULE_ENRTY(bss,embox__framework__LibFramework)
		MODULE_ENRTY(bss,embox__test__mem__memmove)
		MODULE_ENRTY(bss,embox__compat__libc__assert)
		MODULE_ENRTY(bss,embox__lib__Printk)
		MODULE_ENRTY(bss,embox__compat__libc__stdio__print)
		MODULE_ENRTY(bss,embox__compat__libc__stdlib__core)
		MODULE_ENRTY(bss,embox__compat__libc__stdlib__config)
		MODULE_ENRTY(bss,embox__compat__libc__stdlib__rand)
		MODULE_ENRTY(bss,embox__compat__libc__str)
		MODULE_ENRTY(bss,embox__compat__libc__type)
		MODULE_ENRTY(bss,embox__compat__libc__stdio__sprintf)
		MODULE_ENRTY(bss,third_party__lib__libgcc_toolchain)
		MODULE_ENRTY(bss,embox__mem__vmem_depends)
		MODULE_ENRTY(bss,embox__mem__vmem_alloc_single_pool)
		MODULE_ENRTY(bss,embox__mem__mmap_header)
		MODULE_ENRTY(bss,embox__mem__mmap)
		MODULE_ENRTY(bss,embox__mem__marea)
		MODULE_ENRTY(bss,embox__mem__marea_header)
		MODULE_ENRTY(bss,embox__mem__pool_ndebug)
		MODULE_ENRTY(bss,embox__kernel__task__resource__mmap_trivial)
		MODULE_ENRTY(bss,embox__fs__syslib__idesc_mmap_stub)
		MODULE_ENRTY(bss,embox__mem__vmem_header)
		MODULE_ENRTY(bss,embox__kernel__task__kernel_task)
		MODULE_ENRTY(bss,embox__kernel__task__task_resource)
		MODULE_ENRTY(bss,embox__util__Array)
		MODULE_ENRTY(bss,embox__kernel__task__task_table)
		MODULE_ENRTY(bss,embox__driver__periph_memory_mmap)
		MODULE_ENRTY(bss,embox__mem__vmem_device_memory_full)
		MODULE_ENRTY(bss,embox__arch__x86__testtrap)
		MODULE_ENRTY(bss,embox__framework__runlevel)
		MODULE_ENRTY(bss,embox__framework__mod)
		MODULE_ENRTY(bss,embox__util__log)
		MODULE_ENRTY(bss,embox__util__logging)
		MODULE_ENRTY(bss,embox__framework__embuild_full)
		MODULE_ENRTY(bss,embox__lib__debug__symbol)
		MODULE_ENRTY(bss,embox__lib__execinfo__backtrace)
		MODULE_ENRTY(bss,embox__arch__x86__kernel__noacpi_shutdown)
		MODULE_ENRTY(bss,embox__arch__x86__kernel__entry)
		MODULE_ENRTY(bss,embox__arch__x86__boot__multiboot)
		MODULE_ENRTY(bss,embox__compat__posix__proc__vfork_entry)
		MODULE_ENRTY(bss,embox__compat__posix__proc__exit)
		MODULE_ENRTY(bss,embox__compat__posix__proc__signal)
		MODULE_ENRTY(bss,embox__kernel__thread__signal_impl)
		MODULE_ENRTY(bss,embox__kernel__task__resource__sig_table)
		MODULE_ENRTY(bss,embox__compat__posix__proc__sigset)
		MODULE_ENRTY(bss,embox__util__Bitmap)
		MODULE_ENRTY(bss,embox__util__Bit)
		MODULE_ENRTY(bss,embox__kernel__task__resource__argv)
		MODULE_ENRTY(bss,embox__kernel__task__resource__vfork)
		MODULE_ENRTY(bss,embox__driver__clock__pit_regs_x86)
		MODULE_ENRTY(bss,embox__kernel__time__clock_source)
		MODULE_ENRTY(bss,embox__kernel__time__slowdown)
		MODULE_ENRTY(bss,embox__kernel__time__timer_handler)
		MODULE_ENRTY(bss,embox__kernel__lthread__lthread)
		MODULE_ENRTY(bss,embox__kernel__sched__sched)
		MODULE_ENRTY(bss,embox__kernel__sched__idle_thread)
		MODULE_ENRTY(bss,embox__kernel__sched__boot_thread)
		MODULE_ENRTY(bss,embox__kernel__addr_space_stub)
		MODULE_ENRTY(bss,embox__kernel__sched__schedee)
		MODULE_ENRTY(bss,embox__kernel__sched__strategy__runq__prioq)
		MODULE_ENRTY(bss,embox__kernel__sched__priority__inherit)
		MODULE_ENRTY(bss,embox__kernel__sched__affinity__none)
		MODULE_ENRTY(bss,embox__kernel__sched__wait_queue)
		MODULE_ENRTY(bss,embox__util__dlist)
		MODULE_ENRTY(bss,embox__kernel__sched__waitq_protect_link_stub)
		MODULE_ENRTY(bss,embox__kernel__sched__current__default)
		MODULE_ENRTY(bss,embox__driver__serial__core_tty)
		MODULE_ENRTY(bss,embox__util__indexator)
		MODULE_ENRTY(bss,embox__driver__serial__diag)
		MODULE_ENRTY(bss,embox__driver__tty__termios_ops)
		MODULE_ENRTY(bss,embox__util__ring)
		MODULE_ENRTY(bss,embox__driver__char_dev)
		MODULE_ENRTY(bss,embox__net__l2__ethernet)
		MODULE_ENRTY(bss,embox__driver__pci)
		MODULE_ENRTY(bss,embox__driver__pci_chip__pci_chip_x86)
		MODULE_ENRTY(bss,embox__driver__pci_bios_stub)
		MODULE_ENRTY(bss,embox__driver__virtio)
		MODULE_ENRTY(bss,embox__mem__sysmalloc_task_based)
		MODULE_ENRTY(bss,embox__driver__block_dev)
		MODULE_ENRTY(bss,embox__compat__posix__fs__libgen)
		MODULE_ENRTY(bss,embox__fs__buffer_cache)
		MODULE_ENRTY(bss,embox__kernel__thread__mutex)
		MODULE_ENRTY(bss,embox__kernel__sched__mutex)
		MODULE_ENRTY(bss,embox__util__hashtable)
		MODULE_ENRTY(bss,embox__fs__buffer_no_crypt)
		MODULE_ENRTY(bss,embox__driver__common)
		MODULE_ENRTY(bss,embox__compat__posix__util__sleep)
		MODULE_ENRTY(bss,embox__driver__block__partition)
		MODULE_ENRTY(bss,embox__driver__usb__core)
		MODULE_ENRTY(bss,embox__driver__scsi)
		MODULE_ENRTY(bss,embox__driver__usb__hub)
		MODULE_ENRTY(bss,embox__kernel__timer__itimer)
		MODULE_ENRTY(bss,embox__profiler__cyg_profile)
		MODULE_ENRTY(bss,embox__kernel__time__jiffies)
		MODULE_ENRTY(bss,embox__kernel__time__timeval)
		MODULE_ENRTY(bss,embox__kernel__irq_lock)
		MODULE_ENRTY(bss,embox__kernel__irq_stack_no_protection)
		MODULE_ENRTY(bss,embox__kernel__cpu__no_bkl)
		MODULE_ENRTY(bss,embox__kernel__cpu__no_cpudata)
		MODULE_ENRTY(bss,embox__kernel__thread__sched_wait)
		MODULE_ENRTY(bss,embox__compat__posix__proc__vfork_exchanged)
		MODULE_ENRTY(bss,embox__kernel__sched__sched_ticker_preempt)
		MODULE_ENRTY(bss,embox__kernel__sched__timing__running)
		MODULE_ENRTY(bss,embox__kernel__thread__fixed_stack)
		MODULE_ENRTY(bss,embox__kernel__thread__thread_local_heap)
		MODULE_ENRTY(bss,embox__kernel__thread__thread_cancel_disable)
		MODULE_ENRTY(bss,embox__kernel__cpu__common)
		MODULE_ENRTY(bss,embox__compat__posix__util__time)
		MODULE_ENRTY(bss,embox__kernel__thread__stack_protect_none)
		MODULE_ENRTY(bss,embox__util__priolist)
		MODULE_ENRTY(bss,embox__mem__mspace_malloc)
		MODULE_ENRTY(bss,embox__mem__boundary_markers)
		MODULE_ENRTY(bss,embox__mem__heap_afterfree_default)
		MODULE_ENRTY(bss,embox__kernel__task__resource__task_heap)
		MODULE_ENRTY(bss,embox__util__tree)
		MODULE_ENRTY(bss,embox__fs__driver__repo)
		MODULE_ENRTY(bss,embox__fs__filesystem)
		MODULE_ENRTY(bss,embox__fs__syslib__file_system_full)
		MODULE_ENRTY(bss,embox__fs__syslib__noncache)
		MODULE_ENRTY(bss,embox__fs__syslib__perm_full)
		MODULE_ENRTY(bss,embox__fs__syslib__fs_full)
		MODULE_ENRTY(bss,embox__fs__core)
		MODULE_ENRTY(bss,embox__fs__file_desc)
		MODULE_ENRTY(bss,embox__fs__idesc)
		MODULE_ENRTY(bss,embox__kernel__task__resource__idesc_table)
		MODULE_ENRTY(bss,embox__kernel__task__idesc)
		MODULE_ENRTY(bss,embox__fs__xattr)
		MODULE_ENRTY(bss,embox__security__no_security)
		MODULE_ENRTY(bss,embox__fs__path_helper)
		MODULE_ENRTY(bss,embox__compat__posix__util__environ)
		MODULE_ENRTY(bss,embox__kernel__task__resource__errno)
		MODULE_ENRTY(bss,embox__compat__posix__proc__uid)
		MODULE_ENRTY(bss,embox__kernel__task__resource__u_area)
		MODULE_ENRTY(bss,embox__kernel__task__resource__vfs)
		MODULE_ENRTY(bss,embox__compat__posix__util__gettimeofday)
		MODULE_ENRTY(bss,embox__compat__libc__str_dup)
		MODULE_ENRTY(bss,embox__compat__posix__fs__open_old)
		MODULE_ENRTY(bss,embox__driver__ramdisk)
		MODULE_ENRTY(bss,embox__fs__journal)
		MODULE_ENRTY(bss,embox__mem__slab)
		MODULE_ENRTY(bss,embox__net__lib__rpc)
		MODULE_ENRTY(bss,embox__fs__driver__PseudoFs)
		MODULE_ENRTY(bss,embox__driver__flash__flash_nofs)
		MODULE_ENRTY(bss,embox__compat__posix__idx__poll)
		MODULE_ENRTY(bss,embox__compat__posix__idx__poll_table)
		MODULE_ENRTY(bss,embox__fs__idesc_event)
		MODULE_ENRTY(bss,embox__compat__posix__idx__pipe)
		MODULE_ENRTY(bss,embox__compat__posix__fs__file_ops)
		MODULE_ENRTY(bss,embox__compat__posix__fs__read)
		MODULE_ENRTY(bss,embox__compat__posix__fs__write)
		MODULE_ENRTY(bss,embox__compat__posix__fs__fcntl)
		MODULE_ENRTY(bss,embox__compat__posix__fs__ioctl)
		MODULE_ENRTY(bss,embox__compat__posix__fs__close)
		MODULE_ENRTY(bss,embox__compat__posix__fs__fstat)
		MODULE_ENRTY(bss,embox__compat__posix__fs__fsync)
		MODULE_ENRTY(bss,embox__compat__posix__fs__readv)
		MODULE_ENRTY(bss,embox__compat__posix__fs__writev)
		MODULE_ENRTY(bss,embox__compat__posix__fs__ftruncate_old)
		MODULE_ENRTY(bss,embox__compat__posix__idx__select)
		MODULE_ENRTY(bss,embox__compat__posix__pthreads)
		MODULE_ENRTY(bss,embox__kernel__thread__sync)
		MODULE_ENRTY(bss,embox__kernel__thread__sem)
		MODULE_ENRTY(bss,embox__kernel__thread__barrier)
		MODULE_ENRTY(bss,embox__kernel__thread__cond)
		MODULE_ENRTY(bss,embox__kernel__thread__rwlock)
		MODULE_ENRTY(bss,embox__kernel__task__syslib__thread_key_table)
		MODULE_ENRTY(bss,embox__kernel__task__resource__thread_key_table)
		MODULE_ENRTY(bss,embox__framework__test)
		MODULE_ENRTY(bss,embox__compat__posix__idx__ppty)
		MODULE_ENRTY(bss,embox__compat__posix__util__getopt)
		MODULE_ENRTY(bss,embox__lib__Tokenizer)
		MODULE_ENRTY(bss,embox__lib__rl_linenoise)
		MODULE_ENRTY(bss,embox__cmd__sh__shell_registry)
		MODULE_ENRTY(bss,embox__compat__posix__proc__pid)
		MODULE_ENRTY(bss,embox__compat__posix__proc__waitpid)
		MODULE_ENRTY(bss,embox__kernel__task__syslib__waitpid)
		MODULE_ENRTY(bss,embox__kernel__task__resource__waitpid)
		MODULE_ENRTY(bss,embox__compat__posix__passwd)
		MODULE_ENRTY(bss,embox__compat__posix__passwd_db_static)
		MODULE_ENRTY(bss,embox__compat__posix__crypt)
		MODULE_ENRTY(bss,embox__lib__LibCrypt)
		MODULE_ENRTY(bss,embox__compat__libc__stdio__file_ops)
		MODULE_ENRTY(bss,embox__compat__libc__stdio__file_pool)
		MODULE_ENRTY(bss,embox__compat__libc__stdio__open)
		MODULE_ENRTY(bss,embox__compat__posix__idx__dup)
		MODULE_ENRTY(bss,embox__compat__libc__stdio__fputc)
		MODULE_ENRTY(bss,embox__compat__libc__stdio__fwrite)
		MODULE_ENRTY(bss,embox__compat__libc__stdio__funopen)
		MODULE_ENRTY(bss,embox__compat__libc__stdio__stdio_static)
		MODULE_ENRTY(bss,embox__compat__libc__stdio__fputs)
		MODULE_ENRTY(bss,embox__cmd__exit)
		MODULE_ENRTY(bss,embox__cmd__logout)
		MODULE_ENRTY(bss,embox__kernel__task__resource__module_ptr)
		MODULE_ENRTY(bss,embox__init__setup_tty_devfs)
		MODULE_ENRTY(bss,embox__compat__libc__stdio__printf)
		MODULE_ENRTY(bss,embox__compat__posix__proc__exec)
		MODULE_ENRTY(bss,embox__compat__posix__proc__exec_exchanged)
		MODULE_ENRTY(bss,embox__net__neighbour)
		MODULE_ENRTY(bss,embox__net__ndp)
		MODULE_ENRTY(bss,embox__net__lib__icmpv6)
		MODULE_ENRTY(bss,embox__net__lib__ipv6)
		MODULE_ENRTY(bss,embox__net__net_tx)
		MODULE_ENRTY(bss,embox__net__net_no_crypt)
		MODULE_ENRTY(bss,embox__net__no_af_packet)
		MODULE_ENRTY(bss,embox__net__util__macaddr)
		MODULE_ENRTY(bss,embox__compat__posix__net__inet_addr)
		MODULE_ENRTY(bss,embox__compat__libc__stdio__all)
		MODULE_ENRTY(bss,embox__compat__libc__stdio__rename_old)
		MODULE_ENRTY(bss,embox__compat__libc__stdio__fseek)
		MODULE_ENRTY(bss,embox__compat__posix__fs__lseek_old)
		MODULE_ENRTY(bss,embox__compat__libc__stdio__scanf)
		MODULE_ENRTY(bss,embox__compat__libc__stdio__perror)
		MODULE_ENRTY(bss,embox__compat__libc__stdio__div)
		MODULE_ENRTY(bss,embox__net__lib__dns_fixed)
		MODULE_ENRTY(bss,embox__net__lib__dns_query)
		MODULE_ENRTY(bss,embox__compat__posix__net__socket)
		MODULE_ENRTY(bss,embox__net__route)
		MODULE_ENRTY(bss,embox__compat__posix__net__gethostbyname)
		MODULE_ENRTY(bss,embox__compat__posix__net__gethostent)
		MODULE_ENRTY(bss,embox__net__util__hostent)
		MODULE_ENRTY(bss,embox__compat__posix__net__herror)
		MODULE_ENRTY(bss,embox__net__netfilter)
		MODULE_ENRTY(bss,embox__compat__posix__util__getpass)
		MODULE_ENRTY(bss,embox__compat__posix__termios)
		MODULE_ENRTY(bss,embox__driver__tty__tty)
		MODULE_ENRTY(bss,embox__driver__tty__task_breaking_enable)
		MODULE_ENRTY(bss,embox__lib__tftp)
		MODULE_ENRTY(bss,embox__net__lib__snmp)
		MODULE_ENRTY(bss,embox__net__lib__snmp_mib__mib)
		MODULE_ENRTY(bss,embox__net__lib__snmp_mib__all_mibs)
		MODULE_ENRTY(bss,embox__net__lib__snmp_mib__mib_mac)
		MODULE_ENRTY(bss,embox__net__lib__ntp)
		MODULE_ENRTY(bss,embox__net__lib__pop3)
		MODULE_ENRTY(bss,embox__net__lib__smtp)
		MODULE_ENRTY(bss,embox__compat__posix__LibPosix)
		MODULE_ENRTY(bss,embox__compat__posix__fs__all_old)
		MODULE_ENRTY(bss,embox__compat__posix__idx__All)
		MODULE_ENRTY(bss,embox__compat__posix__idx__isatty)
		MODULE_ENRTY(bss,embox__compat__posix__net__All)
		MODULE_ENRTY(bss,embox__compat__posix__net__gai_strerror)
		MODULE_ENRTY(bss,embox__compat__posix__net__getaddrinfo)
		MODULE_ENRTY(bss,embox__compat__posix__net__getprotobynumber)
		MODULE_ENRTY(bss,embox__compat__posix__net__getprotoent)
		MODULE_ENRTY(bss,embox__net__util__protoent)
		MODULE_ENRTY(bss,embox__compat__posix__net__getservent)
		MODULE_ENRTY(bss,embox__net__util__servent)
		MODULE_ENRTY(bss,embox__compat__posix__net__getservbyname)
		MODULE_ENRTY(bss,embox__compat__posix__net__gethostbyaddr)
		MODULE_ENRTY(bss,embox__compat__posix__net__getnameinfo)
		MODULE_ENRTY(bss,embox__compat__posix__net__getnetbyaddr)
		MODULE_ENRTY(bss,embox__compat__posix__net__getnetent)
		MODULE_ENRTY(bss,embox__net__util__netent)
		MODULE_ENRTY(bss,embox__compat__posix__net__getnetbyname)
		MODULE_ENRTY(bss,embox__compat__posix__net__getprotobyname)
		MODULE_ENRTY(bss,embox__compat__posix__net__getservbyport)
		MODULE_ENRTY(bss,embox__compat__posix__proc__All)
		MODULE_ENRTY(bss,embox__compat__posix__proc__nice)
		MODULE_ENRTY(bss,embox__compat__posix__proc__priority)
		MODULE_ENRTY(bss,embox__compat__posix__no_utmp)
		MODULE_ENRTY(bss,embox__compat__posix__util__All)
		MODULE_ENRTY(bss,embox__compat__posix__util__utsname)
		MODULE_ENRTY(bss,embox__compat__posix__util__gethostname)
		MODULE_ENRTY(bss,embox__compat__posix__util__swab)
		MODULE_ENRTY(bss,embox__compat__posix__timerfd)
		MODULE_ENRTY(bss,embox__compat__posix__fnmatch)
		MODULE_ENRTY(bss,embox__compat__posix__utime)
		MODULE_ENRTY(bss,embox__compat__posix__sched)
		MODULE_ENRTY(bss,embox__net__lib__getifaddrs)
		MODULE_ENRTY(bss,third_party__lib__cjson)
		MODULE_ENRTY(bss,embox__compat__libc__stdlib__system)
		MODULE_ENRTY(bss,embox__compat__posix__fs__file_old)
		MODULE_ENRTY(bss,embox__compat__posix__fs__chdir)
		MODULE_ENRTY(bss,embox__compat__posix__fs__getcwd)
		MODULE_ENRTY(bss,embox__compat__posix__fs__dirent_old)
		MODULE_ENRTY(bss,embox__compat__posix__fs__chmod_old)
		MODULE_ENRTY(bss,embox__compat__posix__fs__fsop_old)
		MODULE_ENRTY(bss,embox__compat__posix__LibCurses)
		MODULE_ENRTY(bss,embox__compat__posix__fs__umask)
		MODULE_ENRTY(bss,embox__kernel__task__resource__umask)
		MODULE_ENRTY(bss,embox__framework__cmd)
		MODULE_ENRTY(bss,embox__lib__debug__buildinfo)
		MODULE_ENRTY(bss,embox__compat__libc__time)
		MODULE_ENRTY(bss,embox__framework__mod_integrity)
		MODULE_ENRTY(bss,embox__lib__LibCpuInfo)
		MODULE_ENRTY(bss,embox__arch__x86__cpu_info_x86)
		MODULE_ENRTY(bss,embox__util__pretty_print)
		MODULE_ENRTY(bss,embox__net__sock)
		MODULE_ENRTY(bss,embox__net__family)
		MODULE_ENRTY(bss,embox__net__net_sock)
		MODULE_ENRTY(bss,embox__net__sock_noxattr)
		MODULE_ENRTY(bss,embox__net__packet)
		MODULE_ENRTY(bss,embox__net__lib__ipv4)
		MODULE_ENRTY(bss,embox__net__net_pack)
		MODULE_ENRTY(bss,embox__net__lib__arp)
		MODULE_ENRTY(bss,embox__net__proto)
		MODULE_ENRTY(bss,embox__net__lib__icmpv4)
		MODULE_ENRTY(bss,embox__net__lib__udp)
		MODULE_ENRTY(bss,embox__net__lib__tcp)
		MODULE_ENRTY(bss,embox__net__net_rx)
		MODULE_ENRTY(bss,embox__compat__libc__int_types)
		MODULE_ENRTY(bss,embox__compat__libc__stdlib__all)
		MODULE_ENRTY(bss,embox__compat__libc__stdlib__multibyte)
		MODULE_ENRTY(bss,embox__compat__libc__stdlib__mktemp)
		MODULE_ENRTY(bss,embox__compat__libc__wchar)
		MODULE_ENRTY(bss,embox__util__SListDebug)
		MODULE_ENRTY(bss,embox__kernel__thread__signal__lock)
		MODULE_ENRTY(bss,embox__driver__tty__serial)
		MODULE_ENRTY(bss,embox__fs__index_operation)
		MODULE_ENRTY(bss,third_party__lib__linenoise)
		MODULE_ENRTY(bss,embox__init__diag_fd)
		MODULE_ENRTY(bss,embox__compat__posix__fs__xattr_old)
		MODULE_ENRTY(bss,embox__compat__posix__fs__chown_old)
		MODULE_ENRTY(bss,embox__compat__posix__fs__stat_oldfs)
		MODULE_ENRTY(bss,embox__compat__posix__fs__truncate)
		MODULE_ENRTY(bss,embox__compat__posix__fs__creat)
		*(.bss) } /* .bss */

	.bss..reserve.apps (NOLOAD) : ALIGN(DEFAULT_DATA_ALIGNMENT) {
		/* MAX is a workaround to avoid PROGBITS set on empty section. */
		/* . += MAX(SIZEOF(.data.apps), 1); */
		/* MAX isn't avaible on old ld, at least at 2.20 */
		. += SIZEOF(.data.apps) + 4;
	}
	_app_data_vma = ADDR(.data.apps);
	_app_reserve_vma = ADDR(.bss..reserve.apps);
}
